## drivers/adc/Kconfig.ad74x
```kconfig
# Copyright (c) 2026 William Fish (Manulytica ltd)
# SPDX-License-Identifier: Apache-2.0

config ADC_AD74X
    bool "Analog Devices AD74x ADC"
    default y
    depends on MFD_AD74X
    help
        ADC child driver for AD74x.
```

## drivers/gpio/Kconfig.ad74x
```kconfig
# Copyright (c) 2026 William Fish (Manulytica ltd)
# SPDX-License-Identifier: Apache-2.0

config GPIO_AD74X
    bool "Analog Devices AD74x GPIO"
    default y
    depends on MFD_AD74X
    help
        GPIO child driver for AD74x.
```

## drivers/mfd/Kconfig.ad74x
```kconfig
# Copyright (c) 2026 William Fish (Manulytica ltd)
# SPDX-License-Identifier: Apache-2.0

config MFD_AD74X
    bool "Analog Devices AD74x MFD Support"
    default y
    depends on DT_HAS_ANALOG_AD74X_MFD_ENABLED
    select SPI
    select GPIO
    select NVS
    help
        Parent driver for AD74416H and AD74115H.
```

## drivers/serial/Kconfig.ad74x
```kconfig
# Copyright (c) 2026 William Fish (Manulytica ltd)
# SPDX-License-Identifier: Apache-2.0

config UART_AD74X
    bool "Analog Devices AD74x HART UART"
    default y
    depends on MFD_AD74X
    help
        HART serial child driver for AD74x.
```

## dts/bindings/adc/adi,ad74x-adc.yaml
```yaml
# Copyright (c) 2026 William Fish (Manulytica ltd)
# SPDX-License-Identifier: Apache-2.0

description: AD74x ADC Child
compatible: "adi,ad74x-adc"
include: [adc-controller.yaml]
properties:
  "#io-channel-cells":
    const: 1
```

## dts/bindings/gpio/adi,ad74x-gpio.yaml
```yaml
# Copyright (c) 2026 William Fish (Manulytica ltd)
# SPDX-License-Identifier: Apache-2.0

description: AD74x GPIO Child
compatible: "adi,ad74x-gpio"
include: [gpio-controller.yaml]
properties:
  gpio-controller:
    const: true
  "#gpio-cells":
    const: 2
```

## dts/bindings/mfd/adi,ad74x-mfd.yaml
```yaml
# Copyright (c) 2026 William Fish (Manulytica ltd)
# SPDX-License-Identifier: Apache-2.0

description: |
    Analog Devices AD74x MFD Parent (AD74416H / AD74115H).
    Handles SPI communication, CRC-8, NVS persistence, and safety diagnostics.
compatible: "adi,ad74x-mfd"
include: [spi-device.yaml]
properties:
  chip-type:
    type: string
    required: true
    enum: ["ad74416h", "ad74115h"]
  reset-gpios:
    type: phandle-array
    description: Hardware reset pin (active low).
  adc-rdy-gpios:
    type: phandle-array
    description: Pin to signal ADC conversion completion (active high).
  alert-gpios:
    type: phandle-array
    description: Pin to signal hardware faults (active low).
  partition:
    type: phandle
    description: Flash partition for NVS calibration storage.
  wdt-timeout:
    type: int
    default: 0
    enum: [0, 1, 5, 10, 25, 50, 100, 250, 500, 750, 1000, 2000]
    description: Hardware watchdog timeout in ms. 0 to disable.
```

## dts/bindings/serial/adi,ad74x-uart.yaml
```yaml
# Copyright (c) 2026 William Fish (Manulytica ltd)
# SPDX-License-Identifier: Apache-2.0

description: AD74x HART UART Child
compatible: "adi,ad74x-uart"
include: [uart-controller.yaml]
properties:
  reg:
    type: int
    required: true
    description: Channel ID (0 for AD74115H, 0-3 for AD74416H)
```
