## prj.conf
```kconfig
# Need to use the Full New C-Library for maths functions  
CONFIG_NEWLIB_LIBC=y
CONFIG_NEWLIB_LIBC_FLOAT_PRINTF=y

# Memory Settings
CONFIG_MAIN_STACK_SIZE=4096
CONFIG_SYSTEM_WORKQUEUE_STACK_SIZE=4096
# CONFIG_BT_RX_STACK_SIZE=4096
CONFIG_HEAP_MEM_POOL_SIZE=4096

CONFIG_SCHED_MULTIQ=y


# CONFIG_HW_STACK_PROTECTION=y
# CONFIG_SCHED_MULTIQ=y

# Console Settings
CONFIG_BOOT_BANNER=y
CONFIG_EARLY_CONSOLE=y
CONFIG_STDOUT_CONSOLE=y

# RTT Debugger COMMENT OUT ABOVE
# CONFIG_USE_SEGGER_RTT=y
# CONFIG_RTT_CONSOLE=y
# CONFIG_UART_CONSOLE=n

# I/O and Sensor Settings
CONFIG_GPIO=y
CONFIG_I2C=y
CONFIG_SENSOR=y

# Needed for external Sensors
# ADC Settings
CONFIG_ADC=y
CONFIG_ADC_ASYNC=y
# CONFIG_ADC_0=y
CONFIG_ADC_NRFX_SAADC=y

# nRF5x Die Temp Sensor Settings
CONFIG_TEMP_NRF5=y


# BT Settings
CONFIG_BT=y
CONFIG_BT_RX_BUF_COUNT=30
# CONFIG_BT_TINYCRYPT_ECC=y
CONFIG_BT_OBSERVER=y
CONFIG_BT_BROADCASTER=y

# CONFIG_BT_MAX_CONN=1
# CONFIG_BT_CTLR_RX_BUFFERS=10
# CONFIG_BT_CTLR_TX_BUFFERS=10
CONFIG_BT_CTLR_ADVANCED_FEATURES=y
CONFIG_BT_HCI_CMD_COUNT=4
CONFIG_BT_RX_STACK_SIZE=4096
# CONFIG_BT_HCI_TX_STACK_SIZE=1024

# BT Mesh Settings
CONFIG_BT_MESH=y
CONFIG_BT_MESH_RELAY=n
# CONFIG_BT_MESH_PB_ADV=y
CONFIG_BT_MESH_CFG_CLI=y
CONFIG_BT_MESH_HEALTH_CLI=y

CONFIG_BT_MESH_SUBNET_COUNT=1
CONFIG_BT_MESH_APP_KEY_COUNT=2
CONFIG_BT_MESH_MODEL_GROUP_COUNT=3
CONFIG_BT_MESH_ADV_BUF_COUNT=256
CONFIG_BT_MESH_TX_SEG_MAX=32
CONFIG_BT_MESH_TX_SEG_MSG_COUNT=30
# CONFIG_BT_MESH_RX_SDU_MAX=120
CONFIG_BT_MESH_RX_SEG_MAX=32
CONFIG_BT_MESH_RX_SEG_MSG_COUNT=30

CONFIG_BT_MESH_LABEL_COUNT=0


# Use Stored BT Mesh Settings
# CONFIG_BT_SETTINGS=y 
CONFIG_FLASH=y
CONFIG_FLASH_PAGE_LAYOUT=y
CONFIG_FLASH_MAP=y
CONFIG_FCB=y
CONFIG_SETTINGS=y
CONFIG_SETTINGS_FCB=y
# CONFIG_BT_MESH_RPL_STORE_TIMEOUT=1000



# Debug and console  Settings
# CONFIG_INIT_STACKS=y
# CONFIG_THREAD_STACK_INFO=y
# CONFIG_THREAD_MONITOR=y
# CONFIG_KERNEL_SHELL=y
# CONFIG_THREAD_NAME=y


# Logging Setttings
CONFIG_LOG=n
# CONFIG_KERNEL_LOG_LEVEL_DBG=y
# CONFIG_NET_OFFLOAD_LOG_LEVEL_DBG=y

# This outputs btmon formatted data to the serial port
# CONFIG_BT_DEBUG_MONITOR=y

# CONFIG_BT_DEBUG=y
# CONFIG_BT_DEBUG_LOG=y
# CONFIG_BT_MESH_DEBUG=y
# CONFIG_BT_MESH_DEBUG_SETTINGS=y
# CONFIG_BT_MESH_DEBUG_NET=y
# CONFIG_BT_MESH_DEBUG_MODEL=y
# CONFIG_BT_MESH_DEBUG_TRANS=y
# CONFIG_BT_MESH_DEBUG_ACCESS=y

# CONFIG_BT_MESH_LOW_POWER=y
# CONFIG_BT_MESH_DEBUG_PROV=y
# CONFIG_BT_MESH_DEBUG_LOW_POWER=y
# CONFIG_BT_MESH_DEBUG_BEACON=y
# CONFIG_BT_MESH_DEBUG_CRYPTO=y
# CONFIG_BT_MESH_DEBUG_ADV=y
```

## OKAYprj.conf
```kconfig
# # NEED TO REMOVE FROM CLIENT ######################

# # Enable the MQTT Lib
# CONFIG_MQTT_LIB=y
# CONFIG_MQTT_KEEPALIVE=240



##################### TEST ETHERNET ###############
# # CONFIG_MQTT_LIB_TLS=y
# # CONFIG_NET_SOCKETS_SOCKOPT_TLS=y

# # # TLS configuration
# # CONFIG_MBEDTLS=y
# # CONFIG_MBEDTLS_BUILTIN=y
# # CONFIG_MBEDTLS_ENABLE_HEAP=y
# # CONFIG_MBEDTLS_HEAP_SIZE=30000
# # CONFIG_MBEDTLS_SSL_MAX_CONTENT_LEN=2048


# CONFIG_NET_SOCKETS=y
# CONFIG_NET_TCP=y

# CONFIG_NET_CONFIG_SETTINGS=y
# # CONFIG_NET_CONFIG_MY_IPV6_ADDR="2001:db8::1"
# # CONFIG_NET_CONFIG_PEER_IPV6_ADDR="2001:db8::2"

# CONFIG_NET_CONFIG_MY_IPV4_ADDR="192.168.0.123"
# CONFIG_NET_CONFIG_PEER_IPV4_ADDR="158.176.104.27"  #  v93xbs.messaging.internetofthings.ibmcloud.com
# CONFIG_NET_CONFIG_MY_IPV4_GW="192.168.0.1"

# # "158.176.104.27"  #  v93xbs.messaging.internetofthings.ibmcloud.com
# # "158.175.111.154" //"v93xbs.internetofthings.ibmcloud.com"
# # "169.46.7.59" //"quickstart.messaging.internetofthings.ibmcloud.com"

###################################################

# CONFIG_NETWORKING=y
# CONFIG_NET_CONFIG_SETTINGS=n
# CONFIG_NET_IPV6=n
# CONFIG_NET_IPV4=y
# # CONFIG_NET_TCP=y


# Memory Settings
CONFIG_MAIN_STACK_SIZE=4096
CONFIG_SYSTEM_WORKQUEUE_STACK_SIZE=4096
CONFIG_HEAP_MEM_POOL_SIZE=4096

# Need to use the Full New C-Library for maths functions  
CONFIG_NEWLIB_LIBC=y
CONFIG_NEWLIB_LIBC_FLOAT_PRINTF=y

# CONFIG_HW_STACK_PROTECTION=y
# CONFIG_SCHED_MULTIQ=y

# Console Settings
CONFIG_BOOT_BANNER=y
CONFIG_EARLY_CONSOLE=y
CONFIG_STDOUT_CONSOLE=y


# RTT Debugger COMMENT OUT ABOVE
# CONFIG_HAS_SEGGER_RTT=y
# CONFIG_USE_SEGGER_RTT=y
# CONFIG_RTT_CONSOLE=y
# CONFIG_UART_CONSOLE=n

# I/O and Sensor Settings
CONFIG_GPIO=y
CONFIG_NRFX_GPIOTE=y
CONFIG_I2C=y
CONFIG_SENSOR=y
CONFIG_SPI=n

# FXOS8700 Settings
CONFIG_FXOS8700=n
# CONFIG_FXOS8700_MODE_ACCEL=y
# CONFIG_FXOS8700_MOTION=y
# CONFIG_FXOS8700_PM_LOW_POWER=y
# CONFIG_FXOS8700_TRIGGER_OWN_THREAD=y
# CONFIG_FXOS8700_MODE_HYBRID=n
# CONFIG_FXOS8700_TEMP=n

# BME280 Settings
CONFIG_BME280=n

# APDS9960 Settings
CONFIG_APDS9960=n
CONFIG_APDS9960_TRIGGER_GLOBAL_THREAD=n
CONFIG_DEVICE_POWER_MANAGEMENT=n

# nRF5x Die Temp Sensor Settings
CONFIG_TEMP_NRF5=y

# ADC Settings
CONFIG_ADC=y
CONFIG_ADC_ASYNC=y
CONFIG_ADC_0=y
CONFIG_ADC_NRFX_SAADC=y


# Watchdog Settings
# CONFIG_WDT_LOG_LEVEL_DBG=y
CONFIG_WATCHDOG=y


# BT Settings
CONFIG_BT=y
CONFIG_BT_CTLR_TX_PWR_PLUS_4=y
# CONFIG_BT_RX_BUF_COUNT=30
# CONFIG_BT_TINYCRYPT_ECC=y
CONFIG_BT_OBSERVER=y
CONFIG_BT_BROADCASTER=y


# CONFIG_BT_MAX_CONN=1
CONFIG_BT_CTLR_RX_BUFFERS=10
CONFIG_BT_CTLR_TX_BUFFERS=10
# CONFIG_BT_CTLR_TX_BUFFER_SIZE=1024
CONFIG_BT_CTLR_ADVANCED_FEATURES=y
# CONFIG_BT_CTLR_JOB_PRIO=1
CONFIG_BT_HCI_CMD_COUNT=24
CONFIG_BT_RX_STACK_SIZE=4096
# CONFIG_BT_HCI_TX_STACK_SIZE=1024

# BT Mesh Settings
CONFIG_BT_MESH=y
CONFIG_BT_MESH_RELAY=y
CONFIG_BT_MESH_PB_ADV=n
CONFIG_BT_MESH_CFG_CLI=y
CONFIG_BT_MESH_HEALTH_CLI=y

CONFIG_BT_MESH_PROVISIONER=y
CONFIG_BT_MESH_PB_ADV=y
CONFIG_BT_MESH_NODE_COUNT=10

CONFIG_BT_MESH_SUBNET_COUNT=1
CONFIG_BT_MESH_APP_KEY_COUNT=2
CONFIG_BT_MESH_MODEL_GROUP_COUNT=3
CONFIG_BT_MESH_ADV_BUF_COUNT=256
CONFIG_BT_MESH_TX_SEG_MAX=32
CONFIG_BT_MESH_TX_SEG_MSG_COUNT=30
CONFIG_BT_MESH_RX_SDU_MAX=64
CONFIG_BT_MESH_RX_SEG_MSG_COUNT=30

CONFIG_BT_MESH_LABEL_COUNT=0


# Use Flash Stored BT Mesh Settings
CONFIG_BT_SETTINGS=n
CONFIG_FLASH=y
CONFIG_FLASH_PAGE_LAYOUT=y
CONFIG_FLASH_MAP=y
CONFIG_NVS=y
# CONFIG_FCB=y
CONFIG_SETTINGS=n
# CONFIG_SETTINGS_FCB=y
# CONFIG_BT_MESH_RPL_STORE_TIMEOUT=1000
# 1000000



# Debug and console  Settings
# CONFIG_INIT_STACKS=y
# CONFIG_KERNEL_SHELL=y
# CONFIG_THREAD_STACK_INFO=y
# CONFIG_THREAD_MONITOR=y
# CONFIG_THREAD_NAME=y


# This outputs btmon formatted data to the serial port
# CONFIG_BT_DEBUG_MONITOR=y

# Logging Setttings
CONFIG_LOG=n
# CONFIG_SENSOR_LOG_LEVEL_DBG=y
# CONFIG_LOG_PRINTK=y

# CONFIG_BT_DEBUG_LOG=y
# CONFIG_BT_MESH_DEBUG=y
# CONFIG_BT_MESH_DEBUG_SETTINGS=y
# CONFIG_BT_MESH_DEBUG_NET=y
# CONFIG_BT_MESH_DEBUG_MODEL=y
# CONFIG_BT_MESH_DEBUG_TRANS=y
# CONFIG_BT_MESH_DEBUG_ACCESS=y

# CONFIG_BT_MESH_LOW_POWER=y
# CONFIG_BT_MESH_DEBUG_PROV=y
# CONFIG_BT_MESH_DEBUG_LOW_POWER=y
# CONFIG_BT_MESH_DEBUG_BEACON=y
# CONFIG_BT_MESH_DEBUG_CRYPTO=y
# CONFIG_BT_MESH_DEBUG_ADV=y
```

## ZZZprj_esp32.conf
```kconfig
# # NEED TO REMOVE FROM CLIENT ######################

# # Enable the MQTT Lib
# CONFIG_MQTT_LIB=y
# CONFIG_MQTT_KEEPALIVE=240



##################### TEST ETHERNET ###############
# # CONFIG_MQTT_LIB_TLS=y
# # CONFIG_NET_SOCKETS_SOCKOPT_TLS=y

# # # TLS configuration
# # CONFIG_MBEDTLS=y
# # CONFIG_MBEDTLS_BUILTIN=y
# # CONFIG_MBEDTLS_ENABLE_HEAP=y
# # CONFIG_MBEDTLS_HEAP_SIZE=30000
# # CONFIG_MBEDTLS_SSL_MAX_CONTENT_LEN=2048


# CONFIG_NET_SOCKETS=y
# CONFIG_NET_TCP=y

# CONFIG_NET_CONFIG_SETTINGS=y
# # CONFIG_NET_CONFIG_MY_IPV6_ADDR="2001:db8::1"
# # CONFIG_NET_CONFIG_PEER_IPV6_ADDR="2001:db8::2"

# CONFIG_NET_CONFIG_MY_IPV4_ADDR="192.168.0.123"
# CONFIG_NET_CONFIG_PEER_IPV4_ADDR="158.176.104.27"  #  v93xbs.messaging.internetofthings.ibmcloud.com
# CONFIG_NET_CONFIG_MY_IPV4_GW="192.168.0.1"

# # "158.176.104.27"  #  v93xbs.messaging.internetofthings.ibmcloud.com
# # "158.175.111.154" //"v93xbs.internetofthings.ibmcloud.com"
# # "169.46.7.59" //"quickstart.messaging.internetofthings.ibmcloud.com"

###################################################

# CONFIG_NETWORKING=y
# CONFIG_NET_CONFIG_SETTINGS=n
# CONFIG_NET_IPV6=n
# CONFIG_NET_IPV4=y
# # CONFIG_NET_TCP=y


# Memory Settings
CONFIG_MAIN_STACK_SIZE=4096
CONFIG_SYSTEM_WORKQUEUE_STACK_SIZE=4096
CONFIG_HEAP_MEM_POOL_SIZE=4096


# Need to use the Full New C-Library for maths functions  
# CONFIG_NEWLIB_LIBC=y
# CONFIG_NEWLIB_LIBC_FLOAT_PRINTF=y


# Console Settings
CONFIG_BOOT_BANNER=y
CONFIG_EARLY_CONSOLE=y
CONFIG_STDOUT_CONSOLE=y


# RTT Debugger COMMENT OUT ABOVE
# CONFIG_HAS_SEGGER_RTT=y
# CONFIG_USE_SEGGER_RTT=y
# CONFIG_RTT_CONSOLE=y
# CONFIG_UART_CONSOLE=n

# I/O and Sensor Settings
# CONFIG_GPIO=y
# CONFIG_I2C=y
# CONFIG_SENSOR=n
# CONFIG_SPI=n


# nRF5x Die Temp Sensor Settings


# ADC Settings
CONFIG_ADC=n
# CONFIG_ADC_ASYNC=y
# CONFIG_ADC_0=y


# Watchdog Settings
# CONFIG_WDT_LOG_LEVEL_DBG=y
CONFIG_WATCHDOG=n


# BT Settings
CONFIG_BT=y

# # CONFIG_BT_RX_BUF_COUNT=30
# # CONFIG_BT_TINYCRYPT_ECC=y
CONFIG_BT_OBSERVER=y
CONFIG_BT_BROADCASTER=y
# CONFIG_NET_BUF_USER_DATA_SIZE=1024

# # CONFIG_BT_MAX_CONN=1
# CONFIG_BT_CTLR_RX_BUFFERS=10
# CONFIG_BT_CTLR_TX_BUFFERS=10
# CONFIG_BT_CTLR_ADVANCED_FEATURES=y
# # CONFIG_BT_CTLR_JOB_PRIO=1
# CONFIG_BT_HCI_CMD_COUNT=24
# CONFIG_BT_RX_STACK_SIZE=4096
# # CONFIG_BT_HCI_TX_STACK_SIZE=1024

# BT Mesh Settings
CONFIG_BT_MESH=y
CONFIG_BT_MESH_RELAY=y
CONFIG_BT_MESH_PB_ADV=n
CONFIG_BT_MESH_CFG_CLI=y
CONFIG_BT_MESH_HEALTH_CLI=y

# CONFIG_BT_MESH_PROVISIONER=y
# CONFIG_BT_MESH_PB_ADV=y
# CONFIG_BT_MESH_NODE_COUNT=10

# CONFIG_BT_MESH_SUBNET_COUNT=1
# CONFIG_BT_MESH_APP_KEY_COUNT=2
# CONFIG_BT_MESH_MODEL_GROUP_COUNT=3
# CONFIG_BT_MESH_ADV_BUF_COUNT=256
# CONFIG_BT_MESH_TX_SEG_MAX=32
# CONFIG_BT_MESH_TX_SEG_MSG_COUNT=30
# CONFIG_BT_MESH_RX_SDU_MAX=64
# CONFIG_BT_MESH_RX_SEG_MSG_COUNT=30

# CONFIG_BT_MESH_LABEL_COUNT=0


# Use Flash Stored BT Mesh Settings
# CONFIG_BT_SETTINGS=n
# CONFIG_FLASH=y
# CONFIG_FLASH_PAGE_LAYOUT=y
# CONFIG_FLASH_MAP=y
# CONFIG_NVS=y
# CONFIG_FCB=y
# CONFIG_SETTINGS=n
# CONFIG_SETTINGS_FCB=y
# CONFIG_BT_MESH_RPL_STORE_TIMEOUT=1000
# 1000000



# Debug and console  Settings
# CONFIG_INIT_STACKS=y
# CONFIG_KERNEL_SHELL=y
# CONFIG_THREAD_STACK_INFO=y
# CONFIG_THREAD_MONITOR=y
# CONFIG_THREAD_NAME=y


# This outputs btmon formatted data to the serial port
# CONFIG_BT_DEBUG_MONITOR=y

# Logging Setttings
CONFIG_LOG=n
# CONFIG_SENSOR_LOG_LEVEL_DBG=y
# CONFIG_LOG_PRINTK=y

# CONFIG_BT_DEBUG_LOG=y
# CONFIG_BT_MESH_DEBUG=y
# CONFIG_BT_MESH_DEBUG_SETTINGS=y
# CONFIG_BT_MESH_DEBUG_NET=y
# CONFIG_BT_MESH_DEBUG_MODEL=y
# CONFIG_BT_MESH_DEBUG_TRANS=y
# CONFIG_BT_MESH_DEBUG_ACCESS=y

# CONFIG_BT_MESH_LOW_POWER=y
# CONFIG_BT_MESH_DEBUG_PROV=y
# CONFIG_BT_MESH_DEBUG_LOW_POWER=y
# CONFIG_BT_MESH_DEBUG_BEACON=y
# CONFIG_BT_MESH_DEBUG_CRYPTO=y
# CONFIG_BT_MESH_DEBUG_ADV=y
```

## ZZZprj_thingy52_nrf52832.conf
```kconfig
# Need to use the Full New C-Library for maths functions  
# CONFIG_NEWLIB_LIBC=y
# CONFIG_NEWLIB_LIBC_FLOAT_PRINTF=y

# # Memory Settings
# CONFIG_MAIN_STACK_SIZE=4096
# CONFIG_SYSTEM_WORKQUEUE_STACK_SIZE=4096
# # CONFIG_BT_RX_STACK_SIZE=4096
# CONFIG_HEAP_MEM_POOL_SIZE=4096

# CONFIG_SCHED_MULTIQ=y


# CONFIG_HW_STACK_PROTECTION=y
# CONFIG_SCHED_MULTIQ=y

# Console Settings
CONFIG_BOOT_BANNER=y
CONFIG_EARLY_CONSOLE=y
CONFIG_STDOUT_CONSOLE=y

# RTT Debugger COMMENT OUT ABOVE
# CONFIG_HAS_SEGGER_RTT=y
# CONFIG_USE_SEGGER_RTT=y
# CONFIG_RTT_CONSOLE=y
# CONFIG_UART_CONSOLE=n

# I/O and Sensor Settings
CONFIG_GPIO=y
CONFIG_I2C=y
CONFIG_SENSOR=y

# Needed for external Sensors
# ADC Settings
CONFIG_ADC=y
# CONFIG_ADC_ASYNC=y
# CONFIG_ADC_NRFX_SAADC=y

# nRF5x Die Temp Sensor Settings
CONFIG_TEMP_NRF5=n


# BT Settings
CONFIG_BT=y
CONFIG_BT_RX_BUF_COUNT=30
# CONFIG_BT_TINYCRYPT_ECC=y
CONFIG_BT_OBSERVER=y
CONFIG_BT_BROADCASTER=y

# CONFIG_BT_MAX_CONN=1
# CONFIG_BT_CTLR_RX_BUFFERS=10
# CONFIG_BT_CTLR_TX_BUFFERS=10
CONFIG_BT_CTLR_ADVANCED_FEATURES=y
CONFIG_BT_HCI_CMD_COUNT=4
CONFIG_BT_RX_STACK_SIZE=4096
# CONFIG_BT_HCI_TX_STACK_SIZE=1024

# BT Mesh Settings
CONFIG_BT_MESH=y
CONFIG_BT_MESH_RELAY=n
CONFIG_BT_MESH_PB_ADV=y
CONFIG_BT_MESH_CFG_CLI=y
CONFIG_BT_MESH_HEALTH_CLI=y

CONFIG_BT_MESH_SUBNET_COUNT=1
CONFIG_BT_MESH_APP_KEY_COUNT=2
CONFIG_BT_MESH_MODEL_GROUP_COUNT=3
CONFIG_BT_MESH_ADV_BUF_COUNT=256
CONFIG_BT_MESH_TX_SEG_MAX=32
CONFIG_BT_MESH_TX_SEG_MSG_COUNT=30
CONFIG_BT_MESH_RX_SEG_MAX=32
CONFIG_BT_MESH_RX_SEG_MSG_COUNT=30

CONFIG_BT_MESH_LABEL_COUNT=0


# Use Stored BT Mesh Settings
CONFIG_BT_SETTINGS=y 
CONFIG_FLASH=y
CONFIG_FLASH_PAGE_LAYOUT=y
CONFIG_FLASH_MAP=y
CONFIG_FCB=y
CONFIG_SETTINGS=y
CONFIG_SETTINGS_FCB=y
# CONFIG_BT_MESH_RPL_STORE_TIMEOUT=1000



# Debug and console  Settings
# CONFIG_INIT_STACKS=y
# CONFIG_THREAD_STACK_INFO=y
# CONFIG_THREAD_MONITOR=y
# CONFIG_KERNEL_SHELL=y
# CONFIG_THREAD_NAME=y


# Logging Setttings
CONFIG_LOG=n
# CONFIG_KERNEL_LOG_LEVEL_DBG=y
# CONFIG_NET_OFFLOAD_LOG_LEVEL_DBG=y

# This outputs btmon formatted data to the serial port
# CONFIG_BT_DEBUG_MONITOR=y

# CONFIG_BT_DEBUG=y
# CONFIG_BT_DEBUG_LOG=y
# CONFIG_BT_MESH_DEBUG=y
# CONFIG_BT_MESH_DEBUG_SETTINGS=y
# CONFIG_BT_MESH_DEBUG_NET=y
# CONFIG_BT_MESH_DEBUG_MODEL=y
# CONFIG_BT_MESH_DEBUG_TRANS=y
# CONFIG_BT_MESH_DEBUG_ACCESS=y

# CONFIG_BT_MESH_LOW_POWER=y
# CONFIG_BT_MESH_DEBUG_PROV=y
# CONFIG_BT_MESH_DEBUG_LOW_POWER=y
# CONFIG_BT_MESH_DEBUG_BEACON=y
# CONFIG_BT_MESH_DEBUG_CRYPTO=y
# CONFIG_BT_MESH_DEBUG_ADV=y
```

## prj_arduino_nano_33_ble.conf
```kconfig
# Need to use the Full New C-Library for maths functions  
CONFIG_NEWLIB_LIBC=y
CONFIG_NEWLIB_LIBC_FLOAT_PRINTF=y

# Memory Settings
CONFIG_MAIN_STACK_SIZE=4096
CONFIG_SYSTEM_WORKQUEUE_STACK_SIZE=4096
# CONFIG_BT_RX_STACK_SIZE=4096
CONFIG_HEAP_MEM_POOL_SIZE=4096

CONFIG_SCHED_MULTIQ=y


# CONFIG_HW_STACK_PROTECTION=y
# CONFIG_SCHED_MULTIQ=y


# Console Settings
CONFIG_BOOT_BANNER=y
CONFIG_EARLY_CONSOLE=y
CONFIG_STDOUT_CONSOLE=y
CONFIG_UART_CONSOLE=y
CONFIG_USB_UART_CONSOLE=y
CONFIG_UART_INTERRUPT_DRIVEN=y

# RTT Debugger COMMENT OUT ABOVE
# CONFIG_USE_SEGGER_RTT=y
# CONFIG_RTT_CONSOLE=y
# CONFIG_UART_CONSOLE=n

# I/O and Sensor Settings
CONFIG_GPIO=y
# CONFIG_I2C=y
# CONFIG_SENSOR=y

#Special Config for Nano Board
CONFIG_BOARD_ARDUINO_NANO_33_BLE=y
# CONFIG_BOARD_ARDUINO_NANO_33_BLE_INIT_SENSORS=y
CONFIG_BOARD_ARDUINO_NANO_33_BLE_EN_USB_CONSOLE=y

# Needed for external Sensors
# # ADC Settings
# CONFIG_ADC=y
# CONFIG_ADC_ASYNC=y
# # CONFIG_ADC_0=y
# CONFIG_ADC_NRFX_SAADC=y

# nRF5x Die Temp Sensor Settings
# CONFIG_TEMP_NRF5=y

# LPS22HB Pressure and Temperature sensor
# CONFIG_LPS22HB=y

# HTS221 Humidity and Temperature sensor
# CONFIG_HTS221=y
# CONFIG_HTS221_TRIGGER_NONE=y
# CONFIG_HTS221_TRIGGER_OWN_THREAD=y

# BT Settings
CONFIG_BT=y
# CONFIG_BT_RX_BUF_COUNT=30
# CONFIG_BT_TINYCRYPT_ECC=y
CONFIG_BT_OBSERVER=y
CONFIG_BT_BROADCASTER=y

# CONFIG_BT_MAX_CONN=1
# CONFIG_BT_CTLR_RX_BUFFERS=10
# CONFIG_BT_CTLR_TX_BUFFERS=10
CONFIG_BT_CTLR_ADVANCED_FEATURES=y
# CONFIG_BT_HCI_CMD_COUNT=4
CONFIG_BT_RX_STACK_SIZE=4096
# CONFIG_BT_HCI_TX_STACK_SIZE=1024

# BT Mesh Settings
CONFIG_BT_MESH=y
CONFIG_BT_MESH_RELAY=n
# CONFIG_BT_MESH_PB_ADV=y
CONFIG_BT_MESH_CFG_CLI=y
CONFIG_BT_MESH_HEALTH_CLI=y

CONFIG_BT_MESH_SUBNET_COUNT=1
CONFIG_BT_MESH_APP_KEY_COUNT=2
CONFIG_BT_MESH_MODEL_GROUP_COUNT=3
CONFIG_BT_MESH_ADV_BUF_COUNT=256
CONFIG_BT_MESH_TX_SEG_MAX=32
CONFIG_BT_MESH_TX_SEG_MSG_COUNT=30
# CONFIG_BT_MESH_RX_SDU_MAX=120
CONFIG_BT_MESH_RX_SEG_MAX=32
CONFIG_BT_MESH_RX_SEG_MSG_COUNT=30

CONFIG_BT_MESH_LABEL_COUNT=0


# Use Stored BT Mesh Settings
# CONFIG_BT_SETTINGS=y 
# CONFIG_FLASH=y
# CONFIG_FLASH_PAGE_LAYOUT=y
# CONFIG_FLASH_MAP=y
# CONFIG_FCB=y
# CONFIG_SETTINGS=y
# CONFIG_SETTINGS_FCB=y


# Debug and console  Settings
# CONFIG_INIT_STACKS=y
# CONFIG_THREAD_STACK_INFO=y
# CONFIG_THREAD_MONITOR=y
# CONFIG_KERNEL_SHELL=y
# CONFIG_THREAD_NAME=y


# Logging Setttings
CONFIG_LOG=y
# CONFIG_KERNEL_LOG_LEVEL_DBG=y
# CONFIG_NET_OFFLOAD_LOG_LEVEL_DBG=y

# This outputs btmon formatted data to the serial port
# CONFIG_BT_DEBUG_MONITOR=y

# CONFIG_BT_DEBUG=y
# CONFIG_BT_DEBUG_LOG=y
# CONFIG_BT_MESH_DEBUG=y
# CONFIG_BT_MESH_DEBUG_SETTINGS=y
# CONFIG_BT_MESH_DEBUG_NET=y
# CONFIG_BT_MESH_DEBUG_MODEL=y
# CONFIG_BT_MESH_DEBUG_TRANS=y
# CONFIG_BT_MESH_DEBUG_ACCESS=y

# CONFIG_BT_MESH_LOW_POWER=y
# CONFIG_BT_MESH_DEBUG_PROV=y
# CONFIG_BT_MESH_DEBUG_LOW_POWER=y
# CONFIG_BT_MESH_DEBUG_BEACON=y
# CONFIG_BT_MESH_DEBUG_CRYPTO=y
# CONFIG_BT_MESH_DEBUG_ADV=y
```

## prj_bbc_microbit.conf
```kconfig
CONFIG_ISR_STACK_SIZE=640
CONFIG_MAIN_STACK_SIZE=480
CONFIG_SYSTEM_WORKQUEUE_STACK_SIZE=1024


# CONFIG_ISR_STACK_SIZE=512
# CONFIG_MAIN_STACK_SIZE=512
# CONFIG_SYSTEM_WORKQUEUE_STACK_SIZE=1280
# # CONFIG_SYSTEM_WORKQUEUE_STACK_SIZE=2048
CONFIG_DISPLAY=y
CONFIG_MICROBIT_DISPLAY=y

# EXPERIMENTAL
CONFIG_DEVICE_POWER_MANAGEMENT=n

# Console Settings
# CONFIG_BOOT_BANNER=y
# CONFIG_EARLY_CONSOLE=y
CONFIG_STDOUT_CONSOLE=y

# I/O Settings
CONFIG_GPIO=y
CONFIG_I2C=y
CONFIG_SENSOR=y
CONFIG_SPI=n
# CONFIG_PWM=y
# CONFIG_PWM_NRF5_SW=y


# nRF5x Die Temp Sensor Settings
CONFIG_TEMP_NRF5=y

# # FXOS8700 Settings
# CONFIG_FXOS8700=n
# CONFIG_FXOS8700_MODE_ACCEL=y
# # CONFIG_FXOS8700_RANGE_8G=y
# CONFIG_FXOS8700_RANGE_2G=y
# # CONFIG_FXOS8700_TRIGGER_OWN_THREAD=y
# CONFIG_FXOS8700_TRIGGER_GLOBAL_THREAD=y
# CONFIG_FXOS8700_MOTION=y
# CONFIG_FXOS8700_PM_LOW_POWER=y
# # CONFIG_FXOS8700_MODE_HYBRID=n
# # CONFIG_FXOS8700_TEMP=n


CONFIG_BT=y
CONFIG_BT_RX_STACK_SIZE=1100
# CONFIG_BT_RX_STACK_SIZE=1280
CONFIG_BT_CTLR_DUP_FILTER_LEN=0
CONFIG_BT_OBSERVER=y
CONFIG_BT_BROADCASTER=y
CONFIG_BT_PHY_UPDATE=n
CONFIG_BT_DATA_LEN_UPDATE=n

# BT Mesh Settings
CONFIG_BT_MESH=y
CONFIG_BT_MESH_RELAY=n
CONFIG_BT_MESH_PB_ADV=y
CONFIG_BT_MESH_CFG_CLI=y
CONFIG_BT_MESH_HEALTH_CLI=n

# CONFIG_BT_MESH_RX_SDU_MAX=36
CONFIG_BT_MESH_ADV_BUF_COUNT=10
CONFIG_BT_MESH_TX_SEG_MAX=6
CONFIG_BT_MESH_TX_SEG_MSG_COUNT=3
CONFIG_BT_DISCARDABLE_BUF_COUNT=2

CONFIG_BT_MESH_SUBNET_COUNT=1
CONFIG_BT_MESH_APP_KEY_COUNT=2
CONFIG_BT_MESH_MODEL_GROUP_COUNT=2

# # # ADD AND REMOVE FOR SENSOR MEMORY 
# CONFIG_BT_MESH_ADV_BUF_COUNT=32
# CONFIG_BT_MESH_TX_SEG_MAX=12
# CONFIG_BT_MESH_TX_SEG_MSG_COUNT=6
# CONFIG_BT_MESH_RX_SEG_MSG_COUNT=6
# CONFIG_BT_DISCARDABLE_BUF_COUNT=3


# Use Flash Stored BT Mesh Settings
CONFIG_BT_SETTINGS=n
CONFIG_FLASH=y
CONFIG_FLASH_PAGE_LAYOUT=y
CONFIG_FLASH_MAP=y
CONFIG_FCB=y
CONFIG_SETTINGS=y
CONFIG_SETTINGS_FCB=y
# CONFIG_NVS=y



# ###########################################################

# # Change MCUBootloader Build
# CONFIG_BOOTLOADER_MCUBOOT=n

# CONFIG_ISR_STACK_SIZE=640
# CONFIG_MAIN_STACK_SIZE=480
# # CONFIG_MAIN_STACK_SIZE=1024
# CONFIG_SYSTEM_WORKQUEUE_STACK_SIZE=1024
# # CONFIG_SYSTEM_WORKQUEUE_STACK_SIZE=780


# # EXPERIMENTAL
# CONFIG_DEVICE_POWER_MANAGEMENT=n

# # Output Settings
# CONFIG_DISPLAY=y
# CONFIG_MICROBIT_DISPLAY=y
# # CONFIG_SYS_CLOCK_TICKS_PER_SEC=250

# # Console Settings
# # CONFIG_BOOT_DELAY=500
# CONFIG_BOOT_BANNER=y
# CONFIG_EARLY_CONSOLE=y
# CONFIG_STDOUT_CONSOLE=y


# # I/O Settings
# CONFIG_GPIO=y
# CONFIG_I2C=y
# CONFIG_SENSOR=y
# CONFIG_SPI=n
# # CONFIG_PWM=y
# # CONFIG_PWM_NRF5_SW=y

# # # FXOS8700 Settings
# # CONFIG_BT_DISCARDABLE_BUF_COUNT=10
# # CONFIG_BT_MESH_RX_SDU_MAX=48
# # # CONFIG_BT_MESH_RX_SEG_MSG_COUNT=2
# # CONFIG_BT_MESH_ADV_BUF_COUNT=10

# CONFIG_FXOS8700=y
# CONFIG_FXOS8700_MODE_ACCEL=y
# # CONFIG_FXOS8700_RANGE_8G=y
# CONFIG_FXOS8700_RANGE_2G=y
# # CONFIG_FXOS8700_TRIGGER_OWN_THREAD=y
# CONFIG_FXOS8700_TRIGGER_GLOBAL_THREAD=y
# CONFIG_FXOS8700_MOTION=y
# CONFIG_FXOS8700_PM_LOW_POWER=y
# # CONFIG_FXOS8700_MODE_HYBRID=n
# # CONFIG_FXOS8700_TEMP=n

# # BME280 Settings
# CONFIG_BME280=n
# # CONFIG_BME280_FILTER_OFF=y

# # nRF5x Die Temp Sensor Settings
# # CONFIG_TEMP_NRF5=n
# # CONFIG_HAS_HW_NRF_TEMP=n

# # ADC Settings
# # CONFIG_ADC=y
# # CONFIG_ADC_0=y
# # CONFIG_ADC_NRFX_ADC=y

# # CONFIG_ADC_ASYNC=y
# # CONFIG_HAS_DTS_ADC=y
# # CONFIG_HAS_HW_NRF_ADC=y

# # # Watchdog Settings
# # CONFIG_WDT_LOG_LEVEL_DBG=y
# # CONFIG_WATCHDOG=y


# # BT Settings
# CONFIG_BT=y
# CONFIG_BT_RX_STACK_SIZE=1100
# # CONFIG_BT_RX_STACK_SIZE=2048
# # CONFIG_BT_RX_STACK_SIZE=2220

# CONFIG_BT_CTLR_DUP_FILTER_LEN=0
# CONFIG_BT_OBSERVER=y
# CONFIG_BT_BROADCASTER=y
# CONFIG_BT_PHY_UPDATE=n
# CONFIG_BT_DATA_LEN_UPDATE=n

# # Use legacy BT Controller
# # CONFIG_BT_LL_SW_LEGACY=y


# # BT Mesh Settings
# CONFIG_BT_MESH=y
# CONFIG_BT_MESH_RELAY=n
# CONFIG_BT_MESH_PB_ADV=y
# CONFIG_BT_MESH_CFG_CLI=y
# CONFIG_BT_MESH_HEALTH_CLI=y

# CONFIG_BT_MESH_SUBNET_COUNT=1
# CONFIG_BT_MESH_APP_KEY_COUNT=1
# CONFIG_BT_MESH_MODEL_GROUP_COUNT=1

# # # ADD AND REMOVE FOR SENSOR MEMORY 
# # CONFIG_BT_MESH_ADV_BUF_COUNT=28
# # # CONFIG_BT_MESH_TX_SEG_MAX=12
# # # CONFIG_BT_MESH_TX_SEG_MSG_COUNT=4
# # CONFIG_BT_MESH_RX_SDU_MAX=32
# # # CONFIG_BT_MESH_RX_SEG_MSG_COUNT=4
# CONFIG_BT_DISCARDABLE_BUF_COUNT=3

# CONFIG_BT_MESH_LABEL_COUNT=0

# # Use Flash Stored BT Mesh Settings
# CONFIG_BT_SETTINGS=n
# CONFIG_FLASH=y
# CONFIG_FLASH_PAGE_LAYOUT=y
# CONFIG_FLASH_MAP=y
# CONFIG_FCB=y
# CONFIG_SETTINGS=y
# CONFIG_SETTINGS_FCB=y
# # CONFIG_BT_MESH_RPL_STORE_TIMEOUT=1000


# ## Debugging Settings
# CONFIG_LOG=n
# # # # CONFIG_BT_LOG_LEVEL=4
# # CONFIG_BT_LOG_LEVEL_DBG=y

# # # CONFIG_SENSOR_LOG_LEVEL_DBG=y

# # CONFIG_BT_DEBUG=y
# # CONFIG_BT_DEBUG_LOG=y
# # CONFIG_BT_MESH_DEBUG=y
# # CONFIG_BT_MESH_DEBUG_SETTINGS=y
# # CONFIG_BT_MESH_DEBUG_NET=y
# # CONFIG_BT_MESH_DEBUG_MODEL=y
# # CONFIG_BT_MESH_DEBUG_TRANS=y
# # CONFIG_BT_MESH_SELF_TEST=y
# # CONFIG_BT_MESH_IV_UPDATE_TEST=y
# # CONFIG_BT_MESH_DEBUG_PROV=y
# # CONFIG_BT_MESH_DEBUG_BEACON=y
# # CONFIG_BT_MESH_DEBUG_CRYPTO=y
# # CONFIG_BT_MESH_DEBUG_ADV=y
# # CONFIG_BT_MESH_DEBUG_ACCESS=y
```

## prj_bbc_microbitNEW.conf
```kconfig
#CONFIG_INIT_STACKS=y
CONFIG_ISR_STACK_SIZE=756
CONFIG_MAIN_STACK_SIZE=640
CONFIG_SYSTEM_WORKQUEUE_STACK_SIZE=1200
CONFIG_IDLE_STACK_SIZE=256
# CONFIG_SYSTEM_WORKQUEUE_STACK_SIZE=1200
# CONFIG_SYSTEM_WORKQUEUE_STACK_SIZE=2048
CONFIG_DISPLAY=y
CONFIG_MICROBIT_DISPLAY=y
CONFIG_BOOT_BANNER=n
CONFIG_PWM=n
CONFIG_PWM_NRF5_SW=n

# I/O Settings
CONFIG_GPIO=y
CONFIG_I2C=y
CONFIG_SENSOR=y
CONFIG_SPI=n
CONFIG_DEVICE_POWER_MANAGEMENT=n

# nRF5x Die Temp Sensor Settings
CONFIG_TEMP_NRF5=y

# FXOS8700 Settings
CONFIG_FXOS8700=y
CONFIG_FXOS8700_MODE_ACCEL=y
# CONFIG_FXOS8700_RANGE_8G=y
CONFIG_FXOS8700_RANGE_2G=y
# CONFIG_FXOS8700_TRIGGER_OWN_THREAD=y
CONFIG_FXOS8700_TRIGGER_GLOBAL_THREAD=y
CONFIG_FXOS8700_MOTION=y
CONFIG_FXOS8700_PM_LOW_POWER=y
# CONFIG_FXOS8700_MODE_HYBRID=n
# CONFIG_FXOS8700_TEMP=n


CONFIG_BT=y
CONFIG_BT_RX_STACK_SIZE=1100
CONFIG_BT_CTLR_DUP_FILTER_LEN=0
CONFIG_BT_OBSERVER=y
CONFIG_BT_BROADCASTER=y
CONFIG_BT_PHY_UPDATE=n
CONFIG_BT_DATA_LEN_UPDATE=n

CONFIG_BT_MESH=y
CONFIG_BT_MESH_RELAY=n
CONFIG_BT_MESH_PB_ADV=y
CONFIG_BT_MESH_CFG_CLI=y
CONFIG_BT_MESH_HEALTH_CLI=n

# CONFIG_BT_MESH_RX_SDU_MAX=36
CONFIG_BT_MESH_RX_SEG_MAX=4
CONFIG_BT_MESH_ADV_BUF_COUNT=3
CONFIG_BT_MESH_SEG_BUFS=6
CONFIG_BT_MESH_ADV_BUF_COUNT=6
CONFIG_BT_MESH_TX_SEG_MAX=5
CONFIG_BT_MESH_TX_SEG_MSG_COUNT=3
CONFIG_BT_DISCARDABLE_BUF_COUNT=1

CONFIG_BT_MESH_SUBNET_COUNT=1
CONFIG_BT_MESH_APP_KEY_COUNT=2
CONFIG_BT_MESH_MODEL_GROUP_COUNT=2


CONFIG_BT_SETTINGS=n
CONFIG_FLASH=y
CONFIG_FLASH_PAGE_LAYOUT=y
CONFIG_FLASH_MAP=y
CONFIG_NVS=y
CONFIG_SETTINGS=y


# ###########################################################

# # Change MCUBootloader Build
# CONFIG_BOOTLOADER_MCUBOOT=n

# CONFIG_ISR_STACK_SIZE=640
# CONFIG_MAIN_STACK_SIZE=480
# # CONFIG_MAIN_STACK_SIZE=1024
# CONFIG_SYSTEM_WORKQUEUE_STACK_SIZE=1024
# # CONFIG_SYSTEM_WORKQUEUE_STACK_SIZE=780


# # EXPERIMENTAL
# CONFIG_DEVICE_POWER_MANAGEMENT=n

# # Output Settings
# CONFIG_DISPLAY=y
# CONFIG_MICROBIT_DISPLAY=y
# # CONFIG_SYS_CLOCK_TICKS_PER_SEC=250

# Console Settings
# # CONFIG_BOOT_DELAY=500
# CONFIG_BOOT_BANNER=y
# CONFIG_EARLY_CONSOLE=y
# CONFIG_STDOUT_CONSOLE=y


# # I/O Settings
# CONFIG_GPIO=y
# CONFIG_I2C=y
# CONFIG_SENSOR=y
# CONFIG_SPI=n
# # CONFIG_PWM=y
# # CONFIG_PWM_NRF5_SW=y

# # # FXOS8700 Settings
# # CONFIG_BT_DISCARDABLE_BUF_COUNT=10
# # CONFIG_BT_MESH_RX_SDU_MAX=48
# # # CONFIG_BT_MESH_RX_SEG_MSG_COUNT=2
# # CONFIG_BT_MESH_ADV_BUF_COUNT=10

# CONFIG_FXOS8700=y
# CONFIG_FXOS8700_MODE_ACCEL=y
# # CONFIG_FXOS8700_RANGE_8G=y
# CONFIG_FXOS8700_RANGE_2G=y
# # CONFIG_FXOS8700_TRIGGER_OWN_THREAD=y
# CONFIG_FXOS8700_TRIGGER_GLOBAL_THREAD=y
# CONFIG_FXOS8700_MOTION=y
# CONFIG_FXOS8700_PM_LOW_POWER=y
# # CONFIG_FXOS8700_MODE_HYBRID=n
# # CONFIG_FXOS8700_TEMP=n

# # BME280 Settings
# CONFIG_BME280=n
# # CONFIG_BME280_FILTER_OFF=y

# # nRF5x Die Temp Sensor Settings
# # CONFIG_TEMP_NRF5=n
# # CONFIG_HAS_HW_NRF_TEMP=n

# # ADC Settings
# # CONFIG_ADC=y
# # CONFIG_ADC_0=y
# # CONFIG_ADC_NRFX_ADC=y

# # CONFIG_ADC_ASYNC=y
# # CONFIG_HAS_DTS_ADC=y
# # CONFIG_HAS_HW_NRF_ADC=y

# # # Watchdog Settings
# # CONFIG_WDT_LOG_LEVEL_DBG=y
# # CONFIG_WATCHDOG=y


# # BT Settings
# CONFIG_BT=y
# CONFIG_BT_RX_STACK_SIZE=1100
# # CONFIG_BT_RX_STACK_SIZE=2048
# # CONFIG_BT_RX_STACK_SIZE=2220

# CONFIG_BT_CTLR_DUP_FILTER_LEN=0
# CONFIG_BT_OBSERVER=y
# CONFIG_BT_BROADCASTER=y
# CONFIG_BT_PHY_UPDATE=n
# CONFIG_BT_DATA_LEN_UPDATE=n

# # Use legacy BT Controller
# # CONFIG_BT_LL_SW_LEGACY=y


# # BT Mesh Settings
# CONFIG_BT_MESH=y
# CONFIG_BT_MESH_RELAY=n
# CONFIG_BT_MESH_PB_ADV=y
# CONFIG_BT_MESH_CFG_CLI=y
# CONFIG_BT_MESH_HEALTH_CLI=y

# CONFIG_BT_MESH_SUBNET_COUNT=1
# CONFIG_BT_MESH_APP_KEY_COUNT=1
# CONFIG_BT_MESH_MODEL_GROUP_COUNT=1

# # # ADD AND REMOVE FOR SENSOR MEMORY 
# # CONFIG_BT_MESH_ADV_BUF_COUNT=28
# # # CONFIG_BT_MESH_TX_SEG_MAX=12
# # # CONFIG_BT_MESH_TX_SEG_MSG_COUNT=4
# # CONFIG_BT_MESH_RX_SDU_MAX=32
# # # CONFIG_BT_MESH_RX_SEG_MSG_COUNT=4
# CONFIG_BT_DISCARDABLE_BUF_COUNT=3

# CONFIG_BT_MESH_LABEL_COUNT=0

# # Use Flash Stored BT Mesh Settings
# CONFIG_BT_SETTINGS=n
# CONFIG_FLASH=y
# CONFIG_FLASH_PAGE_LAYOUT=y
# CONFIG_FLASH_MAP=y
# CONFIG_FCB=y
# CONFIG_SETTINGS=y
# CONFIG_SETTINGS_FCB=y
# # CONFIG_BT_MESH_RPL_STORE_TIMEOUT=1000


# ## Debugging Settings
# CONFIG_LOG=n
# # # # CONFIG_BT_LOG_LEVEL=4
# # CONFIG_BT_LOG_LEVEL_DBG=y

# # # CONFIG_SENSOR_LOG_LEVEL_DBG=y

# # CONFIG_BT_DEBUG=y
# # CONFIG_BT_DEBUG_LOG=y
# # CONFIG_BT_MESH_DEBUG=y
# # CONFIG_BT_MESH_DEBUG_SETTINGS=y
# # CONFIG_BT_MESH_DEBUG_NET=y
# # CONFIG_BT_MESH_DEBUG_MODEL=y
# # CONFIG_BT_MESH_DEBUG_TRANS=y
# # CONFIG_BT_MESH_SELF_TEST=y
# # CONFIG_BT_MESH_IV_UPDATE_TEST=y
# # CONFIG_BT_MESH_DEBUG_PROV=y
# # CONFIG_BT_MESH_DEBUG_BEACON=y
# # CONFIG_BT_MESH_DEBUG_CRYPTO=y
# # CONFIG_BT_MESH_DEBUG_ADV=y
# # CONFIG_BT_MESH_DEBUG_ACCESS=y
```

## src/main.c
```c
/* main.c - Application main entry point */
/*
 * Copyright (c) 2019 Manulytica Ltd
 *
 */
#include <zephyr.h>
#include <settings/settings.h>
#include <bluetooth/bluetooth.h>
#include <bluetooth/mesh.h>

#include <drivers/sensor.h>
#include <sys/byteorder.h>
#include <drivers/gpio.h>
#include <sys/printk.h>
#include <sys/__assert.h>
#include <string.h>


#include <common/log.h>

// #if defined(CONFIG_WIFI)
// #if defined(CONFIG_MODEM)
#if defined(CONFIG_MQTT_LIB)
   	// Networking Files
	#include "mqtt/mqtt_pub.c"
#endif
// #endif
// #endif

// Application Files
#include "board.h"
#include "mesh.c"
#include "health_faults.c"
#include "battery_srv.c"
#include "watchdog.c"

/* Sensor Set-up Server Sensor Atrr */
#if defined(CONFIG_FXOS8700)	
	#include "sensor_settings.c"
#endif

#include <device.h>

// #include "sensor_cli.c"

/* added for modem context info */
// #include <drivers/modem/modem_receiver.h>

/* Configure work threads */
// static struct k_work sensor_fxos_work;
// static struct k_work sensor_bme280_work;
// static struct k_work sensor_nrftemp_work;
// static struct k_work mesh_work;

static void bt_ready(int err)
{
	if (err) {
		printk("ERROR: Bluetooth init failed (err %d)\n", err);
		return;
	}

	struct bt_le_oob oob;
	
	printk("Bluetooth initialized\n");

	err = bt_mesh_init(&prov, &comp);
	if (err) {
		printk("ERROR: Initializing mesh failed (err %d)\n", err);
		return;
	}

 	// /* The unprovisioned beacon uses the device address set by Nordic
 	//  * in the FICR as its UUID and is presumed unique.
 	//  * Use identity address as device UUID */
	// if (bt_le_oob_get_local(BT_ID_DEFAULT, &oob)) {
	// 	printk("Identity Address unavailable\n");
	// } else {
	// 	memcpy(dev_uuid, oob.addr.a.val, 6);
	// }

	/* Use identity address as device UUID */
	if (bt_le_oob_get_local(BT_ID_DEFAULT, &oob)) {
		printk("Identity Address unavailable\n");
	} else {
		memcpy(dev_uuid, oob.addr.a.val, 6);
	}


	printk("Mesh initialized\n");

	if (IS_ENABLED(CONFIG_BT_SETTINGS)) {
		printk("Loading stored settings\n");
		// settings_load();

		if( settings_load() ){
			printk("Loading stored settings !!!!!!!!!!!!!!!!!\n");
			err = bt_mesh_provision(net_key, net_idx, flags, iv_index, addr,
						dev_key);
			if (err == -EALREADY) {
				printk("Using stored settings\n");
			} else if (err) {
				printk("ERROR: Provisioning failed (err %d)\n", err);
				// return;
			} else {
				printk("Provisioning completed!\n");
				mesh_configure();
			}
			return;
		}
		printk("ERROR: Loading stored settings\n");
	} 
	
	printk("Awating to be provisioned !\n");
	bt_mesh_prov_enable(BT_MESH_PROV_ADV | BT_MESH_PROV_GATT);

	/* This will be a no-op if settings_load() loaded provisioning info */
	mesh_configure();


// #if NODE_ADDR != GATEWAY_ADDR
// 	/* Heartbeat subcscription is a temporary state (due to there
// 	 * not being an "indefinite" value for the period, so it never
// 	 * gets stored persistently. Therefore, we always have to configure
// 	 * it explicitly.
// 	 */
// 	{
// 		struct bt_mesh_cfg_hb_sub sub = {
// 			.src = GATEWAY_ADDR,
// 			.dst = GROUP_ADDR,
// 			.period = 0x10,
// 		};

// 		bt_mesh_cfg_hb_sub_set(net_idx, addr, &sub, NULL);
// 		printk("Subscribing to heartbeat messages\n");
// 	}
// #endif

	return;
}


// static uint16_t target = SENSOR_ADDR;

// uint16_t board_set_target(void)
// {
// 	switch (target) {
// 	case SENSOR_ADDR:
// 		target = 1U;
// 		break;
// 	case 9:
// 		target = SENSOR_ADDR;
// 		break;
// 	default:
// 		target++;
// 		break;
// 	}

// 	return target;
// }

static uint16_t target = GATEWAY_ADDR;

uint16_t board_set_target(void)
{
	switch (target) {
	case GATEWAY_ADDR:
		target = 1U;
		break;
	case 9:
		target = GATEWAY_ADDR;
		break;
	default:
		target++;
		break;
	}

	return target;
}

/** Strawman function to send bt_mesh_sensor_setting_set message **/
void set_sensor_data(){  // Set Sensor Data function 

	/* send unsolicited request to get sensor readings */
	struct bt_mesh_msg_ctx ctx = {
		.net_idx = net_idx,
		.app_idx = app_idx,
		.addr = target,
		.send_rel = 0U,
		.send_ttl = BT_MESH_TTL_DEFAULT,
	};

	struct bt_mesh_sensor_setting_data setting_data;

	setting_data.sensor_property_id = SENS_PROP_ID_ACCEL_XYZ;
	setting_data.sensor_setting_property_id = 0x002;  /* Trigger value */

	setting_data.sensor_setting_val.val1 = 11;
	setting_data.sensor_setting_val.val2 = 500000;

	bt_mesh_sensor_setting_set(&elements[0], &ctx, &setting_data);
}



void send_sensor_data(uint16_t sensor_id)
{
	// /* Error Trapping */
	// if ((!app_idx) || (!net_idx)){
	// 	printk("ERROR: Could send sensor data (send_sensor_data)\n");
	// 	return;
	// }

	/* send unsolicited request to get sensor readings */
	struct bt_mesh_msg_ctx ctx = {
		.net_idx = net_idx,
		.app_idx = app_idx,
		.addr = target,
		.send_rel = 0U,
		.send_ttl = BT_MESH_TTL_DEFAULT,
	};

	NET_BUF_SIMPLE_DEFINE(msg, 2 + MAX_SENS_STATUS_LEN + 4);
	/* Get sensor data */
	LOG_DBG("Getting status for Sensor ID: 0x%04x\n", sensor_id);
	sensor_status_msg(sensor_id, &msg);

	// printk("ctx size: %d ", sizeof(&ctx));
	// printk(" -- msg size: %d \n", sizeof(&msg));

	/* Send message via SENSOR_SVR */
	/* TODO: Mesh model lookup */
	struct bt_mesh_model *sensor_mod =
		bt_mesh_model_find(&elements[0], BT_MESH_MODEL_ID_SENSOR_SRV);

	int err = (bt_mesh_model_send(sensor_mod, &ctx, &msg, NULL, NULL));

	// int err = (bt_mesh_model_send(&root_models[0], &ctx, &msg, NULL, NULL));
	if (err != 0) {
		LOG_DBG("ERROR: Unable to send status for Sensor ID: 0x%04x\n", sensor_id);
		LOG_DBG("ERROR: bt_mesh_model_send Error ID: %d\n", err);
	} else {
		LOG_DBG("MESSAGE: Sensor message sent OpCode: 0x%04x", sensor_id);
	}

	/* Reset message buffer */
	net_buf_simple_reset(&msg);
}

/** Button 1 unsolicitaed messages sending **/
void board_button_1_pressed(void)
{
	/* send unsolicited request to get sensor readings */
	uint16_t sensor_id = 0;

	sensor_id = SENS_PROP_ID_TEMP; // MPU Die Temp Data

	struct bt_mesh_msg_ctx ctx = {
		.net_idx = net_idx,
		.app_idx = app_idx,
		.addr = target,
		.send_ttl = BT_MESH_TTL_DEFAULT,
	};

	NET_BUF_SIMPLE_DEFINE(msg, 2 + MAX_SENS_STATUS_LEN + 4);
	// NET_BUF_SIMPLE_DEFINE(msg, 1 + 4 + 8);
	sensor_status_msg(sensor_id, &msg);

	/* Send message via SENSOR_SVR */
	/* TODO: Mesh model lookup */
	int rc = (bt_mesh_model_send(&root_models[0], &ctx, &msg, NULL, NULL));

	if (rc != 0) {
		LOG_DBG("ERROR: Unable to send status for Sensor ID: 0x%04x\n", sensor_id);
		LOG_DBG("ERROR: bt_mesh_model_send Error ID: %d\n", rc);
	} else {
		/* success */
		LOG_DBG("MESSAGE: Sensor message sent OpCode: 0x%04x \n", sensor_id);
	}

	/* Reset message buffer */
	net_buf_simple_reset(&msg);
}


/** --------- Start of Health SRV Faults --------- **/
void cmd_health_fault_add(){
	uint8_t err = 0;

	uint8_t fault_code = HEALTH_FAULT_ID_POWER_SUPPLY_INTERRUPTED_ERROR;
	// HEALTH_FAULT_ID_SUPPLY_VOLTAGE_LOW_WARNING   0x03
	// HEALTH_FAULT_ID_SUPPLY_VOLTAGE_LOW_ERROR   0x04
	// HEALTH_FAULT_ID_SUPPLY_VOLTAGE_HIGH_WARNING   0x05
	// HEALTH_FAULT_ID_SUPPLY_VOLTAGE_HIGH_ERROR   0x06
	// HEALTH_FAULT_ID_POWER_SUPPLY_INTERRUPTED_WARNING   0x07
	// HEALTH_FAULT_ID_POWER_SUPPLY_INTERRUPTED_ERROR   0x08

	err = health_fault_add(root_models, fault_code);
	if (err < 0) {
		LOG_DBG("ERROR: Fault add failed !");
	}
}


void cmd_health_del_fault(){
	uint8_t err = 0;

	uint8_t fault_code = HEALTH_FAULT_ID_POWER_SUPPLY_INTERRUPTED_ERROR;
	// HEALTH_FAULT_ID_SUPPLY_VOLTAGE_LOW_WARNING   0x03
	// HEALTH_FAULT_ID_SUPPLY_VOLTAGE_LOW_ERROR   0x04
	// HEALTH_FAULT_ID_SUPPLY_VOLTAGE_HIGH_WARNING   0x05
	// HEALTH_FAULT_ID_SUPPLY_VOLTAGE_HIGH_ERROR   0x06
	// HEALTH_FAULT_ID_POWER_SUPPLY_INTERRUPTED_WARNING   0x07
	// HEALTH_FAULT_ID_POWER_SUPPLY_INTERRUPTED_ERROR   0x08

	err = health_del_fault(root_models, fault_code);
	if (err < 0) {
		LOG_DBG("ERROR: Fault deletion failed !");
	}
}



/** ---- External ADC Sensor Functions ----- **/
#if !defined(CONFIG_BOARD_BBC_MICROBIT)	&& !defined(CONFIG_BOARD_ESP32) && !defined(CONFIG_BOARD_ARDUINO_NANO_33_BLE)
enum adc_action adc_sampling_callback(
				const struct device *dev,
				const struct adc_sequence *sequence,
				uint16_t sampling_index)
{
	struct sensor_value sample_value;
	float cadence_high, cadence_low, value_sample = 0.0, value_delta = 0.0;

	struct bt_mesh_model *mod;
	mod = bt_mesh_model_find(&elements[0], BT_MESH_MODEL_ID_SENSOR_SRV);

	/* Set period divisor */
	// mod->pub->period_div = adc_cadence_data.fast_cadence_period_divisor;
	mod->pub->period_div = 0x04;

	/* Set the Last Sample Value if none exist */
	if (last_sample == 0)
	{
		// last_sample = adc_sample_buffer[0];
		ext_value_convert(&sample_value, adc_sample_buffer[0]);
		last_sample = sensor_value_to_float(&sample_value);
	}
	
	cadence_high=
		sensor_value_to_double(&adc_cadence_data.fast_cadence_high);
	
	cadence_low =
		sensor_value_to_double(&adc_cadence_data.fast_cadence_low);

	int i;	
	for (i = 1; i < ADC_BUFFER_SIZE; i++) {
		ext_value_convert(&sample_value, adc_sample_buffer[i]);
		value_sample = sensor_value_to_float(&sample_value);
		value_delta = last_sample - value_sample;

		
		/** Check fast cadence boundries **/
		/* If Higher than High and Lower than Low */
		if ( cadence_high < cadence_low && value_sample >= cadence_high && value_sample <= cadence_low) 
		{
			/* Increase reporting frequnecy */
			mod->pub->fast_period = 1U;
			// printf("------ AND:  %d\n\n", sensor_srv_period);
		} else if (value_sample >= cadence_high || value_sample <= cadence_low) {
			mod->pub->fast_period = 1U;
			// printf("------ OR:  %d\n\n", sensor_srv_period);
        } else {
			mod->pub->fast_period = 0U;
			// printf("OKay: reset  %d\n\n", sensor_srv_period);
		}

		/* TODO: */
		/* force model to refresh/send publish messages */
		if (mod->pub->period != sensor_srv_period)
		{
			// mod->pub->period = sensor_srv_period;
			// printf("UPDATED: Period %d\n", sensor_srv_period);
			// bt_mesh_model_publish(mod);
		}


		/** Check if Excessive Trigger Delta occured **/
		/* Status Trigger Type 0b1 percentage change */
		if (adc_cadence_data.status_trigger_type == 0b1)
		{
			if (value_delta < 0 && value_delta <= sensor_value_to_float(&adc_cadence_data.status_trigger_delta_down)/100)
			{
				printf("0b1 Value has gone DOWN to fast:%f : %d\n\n", value_delta, i);
				bt_mesh_model_publish(mod);

				printf("SWITCH BACK TO COUNTER !!! \n");
				mod->pub->fast_period = 0U;
				adc_cadence_data.property_id =
					SENS_PROP_ID_COUNTER;
				adc_reset();
				return ADC_ACTION_FINISH; /* Stop Scanning */

			}else if (value_delta > 0 && value_delta >= sensor_value_to_float(&adc_cadence_data.status_trigger_delta_up)/100)
			{
					printf("0b1 Value has gone UP to fast:%f : %d\n\n",  value_delta, i);
					bt_mesh_model_publish(mod);
			}
		/* Status Trigger Type 0b0 defined by UUID Format Type (sec 4.1.1.1) */
		} else if (adc_cadence_data.status_trigger_type == 0b0)
		{
			/* TODO:  */
			if (value_delta < 0 && value_delta <= sensor_value_to_float(&adc_cadence_data.status_trigger_delta_down))
			{
				printf("0b0 Value has gone DOWN to fast:%f : %d\n\n", value_delta, i);
				bt_mesh_model_publish(mod);

			}else if (value_delta > 0 && value_delta >= sensor_value_to_float(&adc_cadence_data.status_trigger_delta_up))
			{
				printf("0b0 Value has gone UP to fast:%f : %d\n\n",  value_delta, i);
				bt_mesh_model_publish(mod);
			}
		}	

		last_sample = value_sample;
	}

	return ADC_ACTION_CONTINUE;
}
#endif

/* External Sensor Timer Stuff (ADC) */
void ext_sensor_work_handler(struct k_work *work)
{
	if (bt_mesh_is_provisioned()){

	#if !defined(CONFIG_BOARD_BBC_MICROBIT)	&& !defined(CONFIG_BOARD_ESP32) && !defined(CONFIG_BOARD_ARDUINO_NANO_33_BLE)
		switch (adc_cadence_data.property_id)
		{
		case SENS_PROP_ID_COUNTER :
		case SENS_PROP_ID_EXT_CNT_TOTAL :
			/* Let the GPIO Callback handle things */
			break;
		default:
			// removed as not using ADC
			// adc_sensor_sampling();
			break;
		}

		/* Just to push timed standard readings */
		send_sensor_data(SENS_PROP_ID_TEMP);
		// send_sensor_data(SENS_PROP_ID_HUMIDITY);
		send_sensor_data(SENS_PROP_ID_ACCEL_XYZ);
		// send_sensor_data(SENS_PROP_ID_EXT_CNT_TOTAL);
		
		// send_sensor_data(SENS_PROP_ID_EXT_PRESSURE);
	#else
		// send_sensor_data(SENS_PROP_ID_TEMP);
		// send_sensor_data(SENS_PROP_ID_EXT_CNT_TOTAL);
		// send_sensor_data(SENS_PROP_ID_EXT_PRESSURE);
	#endif	

	}
}

K_WORK_DEFINE(ext_sensor_work, ext_sensor_work_handler);

void ext_sensor_timer_handler(struct k_timer *ext_sensor_dummy){
    k_work_submit(&ext_sensor_work);
}

K_TIMER_DEFINE(ext_sensor_timer, ext_sensor_timer_handler, NULL);

/* DUMMY COUNT HANDLER FOR External Sensor */
void count_work_handler(struct k_work *count_work)
{
	// Increment the item counter
	ext_item_count++;
	/* Reset counter at 65000 dec */
	if (ext_item_count > 0xfde8) { // 0xfde8
		ext_item_count = 1; 
	}		
}

K_WORK_DEFINE(count_work, count_work_handler);

/* Counter Thread Definitions */
void count_timer_handler(struct k_timer *my_count){
    k_work_submit(&count_work);
}

K_TIMER_DEFINE(count_timer, count_timer_handler, NULL);



/*   ------------ MAIN -----------  */
void main(void){
	int err;

	printk("Initializing...\n");

	/* Initialize the Board Subsystem */
	board_init(&addr);

k_sleep(K_SECONDS(2));

	mpu_temp_init();

	fxos_init();
	apds_init();
	bme_init();
	max_init();
#if !defined(CONFIG_BOARD_BBC_MICROBIT)	&& !defined(CONFIG_BOARD_ESP32) && !defined(CONFIG_BOARD_ARDUINO_NANO_33_BLE)
	init_adc();
#endif

	st_hts221_init();


	
	/* Add the sensor settings to senser set-up server attr list */
#if defined(CONFIG_FXOS8700)	
	add_sensor_attr();
#endif


	printk("Unicast address: 0x%04x\n", addr);

	/* Initialize the Bluetooth Subsystem */
	err = bt_enable(bt_ready);
	if (err) {
		printk("Bluetooth init failed (err %d)\n", err);
	}

	/* Flash the lghts to show 'alive' */
	if (!bt_mesh_is_provisioned()){
		// k_sleep(K_SECONDS(10));
		board_init_complete();
	}


#if defined(CONFIG_BOARD_NRF52840_PCA10056) || defined(CONFIG_BOARD_NRF52_PCA10040)
		nrf_buttons_init();
#endif

	printk("Initialisation Completed \n ");
	printk("\n\n");

	/* Update publishing frequncy */
// #if defined(CONFIG_BOARD_BBC_MICROBIT)
// 	sensor_srv_period = BT_MESH_PUB_PERIOD_100MS(20);
// #else
// 	sensor_srv_period = BT_MESH_PUB_PERIOD_100MS(10);
// #endif

#if defined(CONFIG_LIS2DH)
	printk("888888888888888888888888888888888888888888888888888888888888888888888888\n");
	k_sleep(K_SECONDS(1));	
	lis2_init();
	printk("\n888888888888888888888888888888888888888888888888888888888888888888888888\n");
#endif

	/* External Sensor Timer Stuff ?????? */
	/* start periodic timer that for random count */
	k_timer_start(&count_timer,  _COUNT_TIMER_DELAY, _COUNT_TIMER_DELAY);


	/* start periodic timer that expires once every second */
	k_timer_start(&ext_sensor_timer, _EXT_SENSOR_TIMER_DELAY, _EXT_SENSOR_TIMER_DELAY);


	// while(1){
		/* Main Loop for stuff.... */

	// }
}
```

## src/adc_sensor.h
```c
/*
 * Copyright (c) 2019 Manulytica Ltd
 *
 * SPDX-License-Identifier: Apache-2.0
 */


/** @file
 *  @brief ADC Sensor with Mesh Sensor Setup Model Functions
 */

#include "WIP/sensor_model.h"

#include <math.h>


#define ADC_DEVICE_NAME		DT_LABEL(DT_ALIAS(adc_0))
#define ADC_RESOLUTION		12
#define ADC_GAIN		    ADC_GAIN_1_6 // ADC_GAIN_1
#define ADC_REFERENCE		ADC_REF_INTERNAL
#define ADC_ACQUISITION_TIME	ADC_ACQ_TIME(ADC_ACQ_TIME_MICROSECONDS, 10)
#define ADC_1ST_CHANNEL_ID	0
#define ADC_1ST_CHANNEL_INPUT	NRF_SAADC_INPUT_AIN1
// #define ADC_2ND_CHANNEL_ID	2
#define ADC_2ND_CHANNEL_INPUT	NRF_SAADC_INPUT_AIN2


#define ADC_BUFFER_SIZE  2
static int16_t adc_sample_buffer[ADC_BUFFER_SIZE];

/* Define Global Device */
const struct device *adc_dev;
/* Define External Sensor Cadence Data */
struct bt_mesh_sensor_cadence_data adc_cadence_data = {
    /* Set some defaults */
    .property_id = SENS_PROP_ID_COUNTER,
    // .property_id = SENS_PROP_ID_EXT_TEMP,
};

/* GPIO Callback struct */
static struct gpio_callback adc_gpio_cb;

static const struct adc_channel_cfg adc_1st_channel_cfg = {
	.gain             = ADC_GAIN,
	.reference        = ADC_REFERENCE,
	.acquisition_time = ADC_ACQUISITION_TIME,
	.channel_id       = ADC_1ST_CHANNEL_ID,
#if defined(CONFIG_ADC_CONFIGURABLE_INPUTS)
	.input_positive   = ADC_1ST_CHANNEL_INPUT,
#endif
};
#if defined(ADC_2ND_CHANNEL_ID)
static const struct adc_channel_cfg adc_2nd_channel_cfg = {
	.gain             = ADC_GAIN,
	.reference        = ADC_REFERENCE,
	.acquisition_time = ADC_ACQUISITION_TIME,
	.channel_id       = ADC_2ND_CHANNEL_ID,
#if defined(CONFIG_ADC_CONFIGURABLE_INPUTS)
	.input_positive   = ADC_2ND_CHANNEL_INPUT,
#endif
};
#endif /* defined(ADC_2ND_CHANNEL_ID) */

static const struct adc_channel_cfg adc_empty_channel_cfg = {
	.gain             = ADC_GAIN,
	.reference        = ADC_REFERENCE,
	.acquisition_time = ADC_ACQUISITION_TIME,
};

#define ADC_REF_VOLTAGE_IN_MILLIVOLTS  	3300  //!< Reference voltage (in milli volts) used by ADC while doing conversion.
#define DIODE_FWD_VOLT_DROP_MILLIVOLTS 	270  //!< Typical forward voltage drop of the diode (Part no: SD103ATW-7-F) that is connected in series with the voltage supply. This is the voltage drop when the forward current is 1mA. Source: Data sheet of 'SURFACE MOUNT SCHOTTKY BARRIER DIODE ARRAY' available at www.diodes.com.
#define ADC_RES_12BIT                  	4096.0 //!< Maximum digital value for 12-bit ADC conversion.
#define ADC_PRE_SCALING_COMPENSATION   	1    //!< The ADC is configured to use VDD with 1/3 prescaling as input. And hence the result of conversion is to be multiplied by 3 to get the actual value of the battery voltage.
#define ADC_INPUT_OFFSET				0 //Gain in mVolts
#define ADC_THERMISTOR_B_CONST			1

#define ADC_RESULT_IN_MILLI_VOLTS(ADC_VALUE)                                   \
	(((((ADC_VALUE)*ADC_REF_VOLTAGE_IN_MILLIVOLTS) / ADC_RES_12BIT) +      \
	  ADC_INPUT_OFFSET) *                                                  \
	 ADC_PRE_SCALING_COMPENSATION)


/* Calcuating Temp in C from temp in K */
#define ADC_RESULT_IN_UNITS(ADC_VALUE)                                         \
	(1 / (log(ADC_RES_12BIT / ADC_VALUE - 1.0) / ADC_THERMISTOR_B_CONST +  \
	      1 / 298.15) -                                                    \
	 273.15)


/** Function Stubs **/
/* Initiasation Funtion */
static int init_adc(void);
 
/* Initiasation Funtion */
static int adc_reset(void);


/* ADC Read Callback */
enum adc_action adc_sampling_callback(const struct device *dev,
				      const struct adc_sequence *sequence,
				      uint16_t sampling_index);


/*  Create Sensor Setting Data/Status */
struct bt_mesh_sensor_setting_status *sensor_status_list[30];

/*  Create Sensor Setting Data/Status */
struct bt_mesh_sensor_settings_status sensor_property_ids;
```

## src/apds9960.c
```c
/*
 * Copyright (c) 2017 Intel Corporation
 * Copyright (c) 2018 Phytec Messtechnik GmbH
 * Copyright (c) 2019 Manulytica Ltd
 *
 * SPDX-License-Identifier: Apache-2.0
 */
#ifndef MANULYTICA_ADPS9960_C_
#define MANULYTICA_ADPS9960_C_

#include <zephyr.h>
#include <drivers/sensor.h>
#include <stdio.h>

// #include "apds9960.h"

/* Semaphor starts "not available" */
K_SEM_DEFINE(apds9960_sem, 0, 1);	

/* Define Global Device */
const struct device *apdsdev;

/* struct sensor_value */
void apds_get_value(uint8_t channel, struct sensor_value* light_value)
{

	if (apdsdev == NULL) {
		printk("ERROR: Could read get Light Sensor device\n");
		return;
	}

	/* Always fetch the sample to clear the data ready interrupt in the sensor. */
	if (sensor_sample_fetch(apdsdev)) {
		printk("ERROR: APDS9960 sensor_sample_fetch failed\n");
		return;
	}


sensor_channel_get(apdsdev, SENSOR_CHAN_LIGHT, light_value);
printk("ambient light intensity %f\n", sensor_value_to_double(light_value));

sensor_channel_get(apdsdev, SENSOR_CHAN_PROX, light_value);
printk("proximity %f\n", sensor_value_to_double(light_value));



	/* Take a semaphor flag */
	k_sem_take(&apds9960_sem, K_NO_WAIT);

	// /* GET the readings from sensor based on passed value */
	// if 		(channel == LIGHT_ALL ){ 	/* Get X value */
	// 	sensor_channel_get(apdsdev, SENSOR_CHAN_LIGHT, light_value);
	// }
	// else if (channel == LIGHT_RED ){ 	/* Get Y value */
	// 	sensor_channel_get(apdsdev, SENSOR_CHAN_RED, light_value);
	// }
	// else if (channel == LIGHT_GREEN ){	/* Get Z value */
	// 	sensor_channel_get(apdsdev, SENSOR_CHAN_GREEN, light_value);
	// }
	// else if (channel == LIGHT_BLUE ){ /* Get channel value */
	// 	sensor_channel_get(apdsdev, SENSOR_CHAN_BLUE, light_value);
	// }
	// else if (channel == LIGHT_PROX ){ /* Get channel value */
	// 	sensor_channel_get(apdsdev, SENSOR_CHAN_PROX, light_value);
	// }
	// else {
	// 	/* Default with LIGHT_ALL Value */
	// 	sensor_channel_get(apdsdev, SENSOR_CHAN_LIGHT, light_value);
	// }

	return;
}


#ifdef CONFIG_APDS9960_TRIGGER
// /* Semaphor starts "not available" */
// K_SEM_DEFINE(apds9960_sem, 0, 1);

static void trigger_handler(struct device *apdsdev, struct sensor_trigger *trigger)
{
	ARG_UNUSED(trigger);

	/* Always fetch the sample to clear the data ready interrupt in the sensor. */
	if (sensor_sample_fetch(apdsdev)) {
		printk("ERROR: APDS9960 Sensor_sample_fetch failed\n");
		return;
	}

	/* Show the out on console for monitoring */	
	// sensor_channel_get(apdsdev, SENSOR_CHAN_LIGHT, &intensity);
	// sensor_channel_get(apdsdev, SENSOR_CHAN_PROX, &pdata);

	// printk("APDS9960: ambient light intensity %d, proximity %d\n",
	// 		intensity.val1, pdata.val1);

	// }



	struct sensor_value accel_x, accel_y, accel_z;

	apds_get_value( ACCEL_X , &accel_x);

	printk("X: %3.2f  ", sensor_value_to_double(&accel_x));	
	printk("Y: %3.2f  ", sensor_value_to_double(&accel_y));	
	printk("Z: %3.2f \n", sensor_value_to_double(&accel_z));	

	/*  Send unsolicited request to get sensor readings
	*  Send 1 message containing all axis as a value array */
	send_sensor_data(SENS_PROP_ID_ACCEL_channel); /* Accel channel Values (m/s) */

	/* Take a thread semaphor */
	k_sem_give(&apds9960_sem);
}
#endif


/* APDS-9960 Init */
void apds_init()
{
	struct sensor_value intensity, pdata;

	// apdsdev = device_get_binding(DT_AVAGO_APDS9960_0_LABEL);
	apdsdev = device_get_binding("APDS9960");

	if (apdsdev == NULL) {
		printk("ERROR: Device not found - APDS-9960 \n");
		return;
	}


#ifdef CONFIG_APDS9960_TRIGGER
	struct sensor_value attr = {
		.val1 = 127,
		.val2 = 0,
	};

	if (sensor_attr_set(apdsdev, SENSOR_CHAN_PROX,
			    SENSOR_ATTR_UPPER_THRESH, &attr)) {
		printk("ERROR: APDS9960 Could not set threshold\n");
		return;
	}

	struct sensor_trigger trig = {
		.type = SENSOR_TRIG_THRESHOLD,
		.chan = SENSOR_CHAN_PROX,
	};

	if (sensor_trigger_set(apdsdev, &trig, trigger_handler)) {
		printk("ERROR: APDS9960 Could not set trigger\n");
		return;
	}
#endif


	if (sensor_sample_fetch(apdsdev)) {
		printk("ERROR: APDS9960 sensor_sample fetch failed\n");
	}

	sensor_channel_get(apdsdev, SENSOR_CHAN_LIGHT, &intensity);
	sensor_channel_get(apdsdev, SENSOR_CHAN_PROX, &pdata);

	printk("APDS9960: ambient light intensity %d, proximity %d\n",
			intensity.val1, pdata.val1);

}

/* End of Define trap */
#endif
```
