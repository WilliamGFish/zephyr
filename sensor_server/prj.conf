## CMakeLists.txt
```
cmake_minimum_required(VERSION 3.13.1)
set(QEMU_EXTRA_FLAGS -s)

include($ENV{ZEPHYR_BASE}/cmake/app/boilerplate.cmake NO_POLICY_SCOPE)
project(mesh_demo)

target_sources(app PRIVATE src/main.c)
target_sources_ifdef(CONFIG_BOARD_BBC_MICROBIT app PRIVATE src/microbit.c)
zephyr_include_directories_ifdef(CONFIG_BOARD_BBC_MICROBIT
				 $ENV{ZEPHYR_BASE}/boards/arm/bbc_microbit)

target_sources(app PRIVATE ${app_sources})
target_sources(app PRIVATE ${APPLICATION_SOURCE_DIR}/src//mqtt_iot/google/private_info/key.c)
zephyr_include_directories(${APPLICATION_SOURCE_DIR}/src//mqtt_iot/google/tls_config)


if(NODE_ADDR)
  zephyr_compile_definitions(NODE_ADDR=${NODE_ADDR})
endif()
```

## Kconfig
```
# Private config options for Modem & MQTT

# Copyright (c) 2019 Intel Corporation
# SPDX-License-Identifier: Apache-2.0

mainmenu "Networking MQTT application"

choice
     prompt "Cloud Platform"
     optional

config CLOUD_AZURE_PLATFORM
    bool "Azure IoT Platform"

config CLOUD_GOOGLE_PLATFORM
    bool "Google IoT Platform"

endchoice	  


config WIFI_SSID
	string "SSID Name"
	help
	  Name of WiFi Acces Point SSID.

config WIFI_PASSWORD
	string "Cloud password"
	help
	  Password of your WiFi account.

mainmenu "Networking MQTT application"

config CLOUD_USERNAME
	string "Cloud username"
	help
	  Username of your Azure account.

config CLOUD_PASSWORD
	string "Cloud password"
	help
	  Password of your Azure account.

config CLOUD_CLIENT_ID
	string "Cloud IoT hub MQTT client ID"
	help
	  Device ID which you have setup in IoT hub account.

config CLOUD_HOSTNAME
	string "Cloud IoT hub hostname"
	help
	  Hostname of your Cloud IoT hub.

config CLOUD_SERVER_ADDR
	string "Cloud server address"
	help
	  Cloud server address.

config CLOUD_SERVER_PORT
	int "Cloud server port number"
	default 8883
	help
	  Cloud server port number.

config PROXY_SOCKS_ADDR
	string "Proxy address"
	depends on SOCKS
	help
	  Provide proxy address if you are running this application
	  behind proxy.

config PROXY_SOCKS_PORT
	int "Proxy port"
	depends on SOCKS
	help
	  Provide proxy port if you are running this application
	  behind proxy.

mainmenu "Google IOT MQTT/TLS sample application"

config CLOUD_AUDIENCE
	string "Audience string"
	default "put audience string here"
	help
	  Set required audience string that matches Google Cloud project

config CLOUD_SUBSCRIBE_CONFIG
	string "Subscription string for config"
	default "put subscription string here"
	help
	  Set required subscription string that matches Google Cloud project
	  config item.

config CLOUD_PUBLISH_TOPIC
	string "Publish topic string"
	default "put topic string here"
	help
	  Set publish topics string that matches Google Cloud project
source "Kconfig.zephyr"
```

## sample.yaml
```
sample:
  name: Bluetooth Mesh Demo
tests:
  test:
    harness: bluetooth
    platform_whitelist: bbc_microbit nrf51_blenano qemu_x86 nrf52840_pca10056
    tags: bluetooth
```

## prj.conf
```kconfig
# RTT Debugger COMMENT OUT ABOVE
CONFIG_USE_SEGGER_RTT=y
CONFIG_RTT_CONSOLE=y
CONFIG_UART_CONSOLE=n

# Need to use the Full New C-Library for maths functions  
CONFIG_NEWLIB_LIBC=y
CONFIG_NEWLIB_LIBC_FLOAT_PRINTF=y

# Memory Settings
CONFIG_MAIN_STACK_SIZE=4096
CONFIG_SYSTEM_WORKQUEUE_STACK_SIZE=4096
CONFIG_HEAP_MEM_POOL_SIZE=4096

CONFIG_SCHED_MULTIQ=y

# I/O and Sensor Settings
CONFIG_GPIO=y
CONFIG_I2C=y
CONFIG_SENSOR=y

# Needed for external Sensors
# ADC Settings
CONFIG_ADC=y
CONFIG_ADC_ASYNC=y
CONFIG_ADC_NRFX_SAADC=y

# nRF5x Die Temp Sensor Settings
CONFIG_TEMP_NRF5=y


CONFIG_BT=y
CONFIG_BT_TINYCRYPT_ECC=y

CONFIG_BT_OBSERVER=y
CONFIG_BT_BROADCASTER=y

CONFIG_BT_MESH=y
CONFIG_BT_MESH_LABEL_COUNT=0
CONFIG_BT_MESH_CFG_CLI=y
CONFIG_BT_MESH_HEALTH_CLI=y

CONFIG_BT_MESH_PROVISIONER=y
CONFIG_BT_MESH_CDB=y
CONFIG_BT_MESH_CDB_NODE_COUNT=10
CONFIG_BT_MESH_CDB_SUBNET_COUNT=3
CONFIG_BT_MESH_CDB_APP_KEY_COUNT=3

# Experimental *************
CONFIG_BT_MESH_CDB_ADDR_REISSUE=y

CONFIG_BT_MESH_SUBNET_COUNT=1
CONFIG_BT_MESH_APP_KEY_COUNT=2
CONFIG_BT_MESH_MODEL_GROUP_COUNT=3
CONFIG_BT_MESH_ADV_BUF_COUNT=256
CONFIG_BT_MESH_TX_SEG_MAX=32
CONFIG_BT_MESH_TX_SEG_MSG_COUNT=30
# CONFIG_BT_MESH_RX_SDU_MAX=120
CONFIG_BT_MESH_ADV_BUF_COUNT=120
CONFIG_BT_MESH_SEG_BUFS=120
CONFIG_BT_MESH_RX_SEG_MAX=32
CONFIG_BT_MESH_RX_SEG_MSG_COUNT=30

CONFIG_SETTINGS=y
CONFIG_BT_SETTINGS=y
CONFIG_FLASH=y
CONFIG_FLASH_PAGE_LAYOUT=y
CONFIG_FLASH_MAP=y
CONFIG_NVS=y


# CONFIG_BT_DEBUG_LOG=y
# CONFIG_BT_MESH_DEBUG=y
# CONFIG_BT_MESH_DEBUG_SETTINGS=y
#CONFIG_BT_MESH_DEBUG_NET=y
# CONFIG_BT_MESH_DEBUG_MODEL=y
#CONFIG_BT_MESH_DEBUG_TRANS=y
# CONFIG_BT_MESH_DEBUG_ACCESS=y

#CONFIG_BT_MESH_LOW_POWER=y
# CONFIG_BT_MESH_DEBUG_PROV=y
#CONFIG_BT_MESH_DEBUG_LOW_POWER=y
#CONFIG_BT_MESH_DEBUG_BEACON=y
#CONFIG_BT_MESH_DEBUG_CRYPTO=y
#CONFIG_BT_MESH_DEBUG_ADV=y
```

## overlay-azure-mqtt.conf
```kconfig
# Azure IoT Set-up
# CONFIG_CLOUD_AZURE_PLATFORM=y
# CONFIG_CLOUD_USERNAME="zephyrtest001.azure-devices.net/argongateway01/?api-version=2018-06-30"
# # CONFIG_CLOUD_USERNAME="zephyrtest001.azure-devices.net/argongateway02/?api-version=2018-06-30"
# # CONFIG_CLOUD_PASSWORD="mFtsazp2RZJxpzfV3bcXbmrEOP4Pw4gHTNqoXBHgg0o="
# CONFIG_CLOUD_PASSWORD="SharedAccessSignature sr=zephyrtest001.azure-devices.net%2Fdevices%2Fargongateway01&sig=yEJntdcualmhj3BqoUYig0yc09rpAUuzf7SGG76i0Cw%3D&se=1612957115"
# # CONFIG_CLOUD_PASSWORD="SharedAccessSignature sr=zephyrtest001.azure-devices.net%2Fdevices%2Fargongateway01&sig=qdSZAXScgoOb85YDPY7T1ZH0zucqXGV2XrEQM1Cm0Jc%3D&se=1604137166"
# # CONFIG_CLOUD_PASSWORD="SharedAccessSignature sr=zephyrtest001.azure-devices.net%2Fdevices%2Fargongateway01&sig=zSdhi6pArfsjmlOzCRhHktTur6PkN4n%2BrbEt22R6F04%3D&se=1603493315"
# # CONFIG_CLOUD_PASSWORD="SharedAccessSignature sr=zephyrtest001.azure-devices.net%2Fdevices%2Fargongateway01&sig=HToDFDWjieksaI%2BrzMnCeISzsrIHM9IXuhYti8LmIZA%3D&se=1603445317"
# CONFIG_CLOUD_CLIENT_ID="argongateway01"
# # CONFIG_CLOUD_CLIENT_ID="argongateway02"
# CONFIG_CLOUD_HOSTNAME="zephyrtest001.azure-devices.net"
# CONFIG_CLOUD_SERVER_ADDR=""
# CONFIG_CLOUD_SERVER_PORT=8883


# # Mosquitto Test Set-up
# CONFIG_CLOUD_AZURE_PLATFORM=y
# CONFIG_CLOUD_USERNAME=""
# CONFIG_CLOUD_PASSWORD=""
# CONFIG_CLOUD_CLIENT_ID="argon"
# CONFIG_CLOUD_HOSTNAME="test.mosquitto.org"
# CONFIG_CLOUD_SERVER_ADDR=""


# # Tago IO Test Set-up
# CONFIG_CLOUD_AZURE_PLATFORM=y
# CONFIG_CLOUD_USERNAME="argongateway01"
# CONFIG_CLOUD_PASSWORD="e0844c25-bf76-4432-b5ac-4ac7d2d1eae3"
# # e0844c25-bf76-4432-b5ac-4ac7d2d1eae3
# CONFIG_CLOUD_CLIENT_ID="argongateway01"
# CONFIG_CLOUD_HOSTNAME="mqtt.tago.io"

# KAA IoT Test Set-up
CONFIG_CLOUD_AZURE_PLATFORM=y
CONFIG_CLOUD_USERNAME="manulytica@039d03d4-846c-4d0e-8d39-6ac85da26edc"
CONFIG_CLOUD_PASSWORD="manulytica"
CONFIG_CLOUD_CLIENT_ID="argongateway01"
CONFIG_CLOUD_HOSTNAME="mqtt.cloud.kaaiot.com"
# topic contains farther connection info
# # CONFIG_MQTT_CLEAN_SESSION=y

# Set-up MQTT in User Space
CONFIG_USERSPACE=y
CONFIG_HW_STACK_PROTECTION=y
CONFIG_MAX_THREAD_BYTES=8
CONFIG_NET_TC_THREAD_COOPERATIVE=y 

# Enable Sockets support
CONFIG_NET_SOCKETS=y

# Enable MQTT Lib support
CONFIG_MQTT_LIB=y
CONFIG_CLOUD_SERVER_PORT=1883

# Secure Settings
# CONFIG_MQTT_LIB_TLS=y
# CONFIG_NET_SOCKETS_SOCKOPT_TLS=y
# CONFIG_CLOUD_SERVER_PORT=8883
# # Enable Mbed TLS configuration
# CONFIG_MBEDTLS=y
# CONFIG_MBEDTLS_BUILTIN=y
# CONFIG_MBEDTLS_ENABLE_HEAP=y
# CONFIG_MBEDTLS_HEAP_SIZE=75000
# # 100000
# CONFIG_MBEDTLS_SSL_MAX_CONTENT_LEN=16384
# CONFIG_MBEDTLS_PEM_CERTIFICATE_FORMAT=y
# CONFIG_MBEDTLS_KEY_EXCHANGE_RSA_PSK_ENABLED=y

CONFIG_NEWLIB_LIBC=y

CONFIG_NETWORKING=y

# Disable IPv6 support
CONFIG_NET_IPV6=n

# Enable IPv4 support
CONFIG_NET_IPV4=y
CONFIG_NET_IF_MAX_IPV4_COUNT=2
CONFIG_NET_IF_UNICAST_IPV4_ADDR_COUNT=3

# # Enable TCP support
CONFIG_NET_TCP=y

# # Enable DHCPv4 support
CONFIG_NET_DHCPV4=y

# # Enable SOCKS5 proxy support
CONFIG_SOCKS=n
# CONFIG_PROXY_SOCKS_ADDR="Proxy address"
# CONFIG_PROXY_SOCKS_PORT=<proxy port>


# Network configuration
# CONFIG_NET_CONFIG_SETTINGS=y

# Network connection manager
CONFIG_NET_CONNECTION_MANAGER=y

CONFIG_NET_MGMT_EVENT_STACK_SIZE=1024
CONFIG_NET_MGMT_EVENT_QUEUE_SIZE=5
CONFIG_NET_MGMT_EVENT_LOG_LEVEL_DBG=n


CONFIG_INIT_STACKS=y
CONFIG_NET_SHELL=y


# # Enable Logging support
# CONFIG_NET_LOG=y
# CONFIG_NET_TCP_LOG_LEVEL_DBG=y
# CONFIG_NET_SOCKETS_LOG_LEVEL_DBG=y
# CONFIG_MQTT_LOG_LEVEL_DBG=y
# CONFIG_NET_DHCPV4_LOG_LEVEL_INF=y
# CONFIG_NET_IF_LOG_LEVEL_DBG=y
# CONFIG_MBEDTLS_DEBUG=y
# CONFIG_MBEDTLS_DEBUG_LEVEL=4
# CONFIG_SOCKS_LOG_LEVEL_DBG=y
# CONFIG_NET_CONFIG_LOG_LEVEL_DBG=y
# CONFIG_NET_CONNECTION_MANAGER_LOG_LEVEL_DBG=y
# CONFIG_DNS_RESOLVER_LOG_LEVEL_DBG=y
# CONFIG_NET_CONTEXT_LOG_LEVEL_DBG=y
```

## overlay-google-mqtt.conf
```kconfig
CONFIG_CLOUD_GOOGLE_PLATFORM=y

CONFIG_NETWORKING=y
CONFIG_NET_IPV6=n
CONFIG_NET_IPV4=y
CONFIG_NET_UDP=y
CONFIG_NET_TCP=y
CONFIG_NET_DHCPV4=y
# CONFIG_STDOUT_CONSOLE=y

CONFIG_NET_PKT_RX_COUNT=4
CONFIG_NET_PKT_TX_COUNT=4
CONFIG_NET_BUF_RX_COUNT=12
CONFIG_NET_BUF_TX_COUNT=12

# # CONFIG_INIT_STACKS=y

CONFIG_JWT=y
CONFIG_JWT_SIGN_ECDSA=y

CONFIG_NET_MGMT=y
CONFIG_NET_MGMT_EVENT=y

# CONFIG_LOG=y

# This shouldn't need to be set, but isn't selected properly.
CONFIG_NEWLIB_LIBC=y

CONFIG_DNS_SERVER_IP_ADDRESSES=y
CONFIG_DNS_SERVER1="8.8.8.8"

CONFIG_DNS_RESOLVER=y
CONFIG_DNS_RESOLVER_ADDITIONAL_BUF_CTR=2
CONFIG_SNTP=y

CONFIG_SLIP_STATISTICS=n

CONFIG_HW_STACK_PROTECTION=y
CONFIG_MAIN_STACK_SIZE=4096

CONFIG_MBEDTLS_SSL_MAX_CONTENT_LEN=16384

# CONFIG_DEBUG_OPTIMIZATIONS=y

CONFIG_PTHREAD_IPC=n
CONFIG_NET_SOCKETS=y
CONFIG_MQTT_LIB=y
CONFIG_MQTT_LIB_TLS=y
CONFIG_NET_SOCKETS_SOCKOPT_TLS=y


# Enable MBEDTLS
CONFIG_MBEDTLS=y
CONFIG_MBEDTLS_BUILTIN=y

CONFIG_NET_SOCKETS_POSIX_NAMES=y

CONFIG_MBEDTLS_ENABLE_HEAP=y
CONFIG_MBEDTLS_HEAP_SIZE=56240
CONFIG_MBEDTLS_USER_CONFIG_ENABLE=y
CONFIG_MBEDTLS_USER_CONFIG_FILE="user-tls.conf"

# Please see README.rst in this directory for instructions
# on where to get the values for these config entries.
CONFIG_CLOUD_CLIENT_ID="projects/<PROJECT_ID>/locations/<REGION>/registries/<REGISTRY_ID>/devices/<DEVICE_ID>"
CONFIG_CLOUD_AUDIENCE="<PROJECT_ID>"
CONFIG_CLOUD_SUBSCRIBE_CONFIG="/devices/<DEVICE_ID>/config"
CONFIG_CLOUD_PUBLISH_TOPIC="/devices/<DEVICE_ID>/state"
```

## prj - Copy.conf
```kconfig
# # NEED TO REMOVE FROM CLIENT ######################

# # Enable the MQTT Lib
# CONFIG_MQTT_LIB=y
# CONFIG_MQTT_KEEPALIVE=240



##################### TEST ETHERNET ###############
# # CONFIG_MQTT_LIB_TLS=y
# # CONFIG_NET_SOCKETS_SOCKOPT_TLS=y

# # # TLS configuration
# # CONFIG_MBEDTLS=y
# # CONFIG_MBEDTLS_BUILTIN=y
# # CONFIG_MBEDTLS_ENABLE_HEAP=y
# # CONFIG_MBEDTLS_HEAP_SIZE=30000
# # CONFIG_MBEDTLS_SSL_MAX_CONTENT_LEN=2048


# CONFIG_NET_SOCKETS=y
# CONFIG_NET_TCP=y

# CONFIG_NET_CONFIG_SETTINGS=y
# # CONFIG_NET_CONFIG_MY_IPV6_ADDR="2001:db8::1"
# # CONFIG_NET_CONFIG_PEER_IPV6_ADDR="2001:db8::2"

# CONFIG_NET_CONFIG_MY_IPV4_ADDR="192.168.0.123"
# CONFIG_NET_CONFIG_PEER_IPV4_ADDR="158.176.104.27"  #  v93xbs.messaging.internetofthings.ibmcloud.com
# CONFIG_NET_CONFIG_MY_IPV4_GW="192.168.0.1"

# # "158.176.104.27"  #  v93xbs.messaging.internetofthings.ibmcloud.com
# # "158.175.111.154" //"v93xbs.internetofthings.ibmcloud.com"
# # "169.46.7.59" //"quickstart.messaging.internetofthings.ibmcloud.com"

###################################################

# CONFIG_NETWORKING=y
# CONFIG_NET_CONFIG_SETTINGS=n
# CONFIG_NET_IPV6=n
# CONFIG_NET_IPV4=y
# # CONFIG_NET_TCP=y


# Need to use the Full New C-Library for maths functions  
CONFIG_NEWLIB_LIBC=y
CONFIG_NEWLIB_LIBC_FLOAT_PRINTF=y

# Memory Settings
CONFIG_MAIN_STACK_SIZE=4096
CONFIG_SYSTEM_WORKQUEUE_STACK_SIZE=4096
CONFIG_HEAP_MEM_POOL_SIZE=4096

CONFIG_SCHED_MULTIQ=y

# Console Settings
CONFIG_BOOT_BANNER=y
CONFIG_EARLY_CONSOLE=y
CONFIG_STDOUT_CONSOLE=y
CONFIG_UART_CONSOLE=y

# RTT Debugger COMMENT OUT ABOVE
# CONFIG_HAS_SEGGER_RTT=y
# CONFIG_USE_SEGGER_RTT=y
# CONFIG_RTT_CONSOLE=y
# CONFIG_UART_CONSOLE=n

# I/O and Sensor Settings
CONFIG_GPIO=y
CONFIG_NRFX_GPIOTE=y
CONFIG_I2C=y
CONFIG_SENSOR=y
CONFIG_SPI=n

# FXOS8700 Settings
CONFIG_FXOS8700=n
# CONFIG_FXOS8700_MODE_ACCEL=y
# CONFIG_FXOS8700_MOTION=y
# CONFIG_FXOS8700_PM_LOW_POWER=y
# CONFIG_FXOS8700_TRIGGER_OWN_THREAD=y
# CONFIG_FXOS8700_MODE_HYBRID=n
# CONFIG_FXOS8700_TEMP=n

# BME280 Settings
CONFIG_BME280=n

# APDS9960 Settings
CONFIG_APDS9960=n
CONFIG_APDS9960_TRIGGER_GLOBAL_THREAD=n
CONFIG_DEVICE_POWER_MANAGEMENT=n

# nRF5x Die Temp Sensor Settings
CONFIG_TEMP_NRF5=y

# ADC Settings
CONFIG_ADC=y
CONFIG_ADC_ASYNC=y
# CONFIG_ADC_0=y
CONFIG_ADC_NRFX_SAADC=y


# Watchdog Settings
# CONFIG_WDT_LOG_LEVEL_DBG=y
CONFIG_WATCHDOG=y
CONFIG_WDT_DISABLE_AT_BOOT=n


# BT Settings
CONFIG_BT=y
# CONFIG_BT_CTLR_TX_PWR_PLUS_4=y
CONFIG_BT_RX_BUF_COUNT=30
CONFIG_BT_TINYCRYPT_ECC=y
CONFIG_BT_OBSERVER=y
CONFIG_BT_BROADCASTER=y


# CONFIG_BT_MAX_CONN=1
CONFIG_BT_CTLR_RX_BUFFERS=10
CONFIG_BT_CTLR_TX_BUFFERS=10
# CONFIG_BT_CTLR_TX_BUFFER_SIZE=1024
CONFIG_BT_CTLR_ADVANCED_FEATURES=y
# CONFIG_BT_CTLR_JOB_PRIO=1
CONFIG_BT_HCI_CMD_COUNT=24
CONFIG_BT_RX_STACK_SIZE=4096


# BT Mesh Settings
CONFIG_BT_MESH=y
CONFIG_BT_MESH_RELAY=n
CONFIG_BT_MESH_CFG_CLI=y
CONFIG_BT_MESH_HEALTH_CLI=y

# Mesh Message of capacity of the replay protection list (default 10)
CONFIG_BT_MESH_CRPL=1000
# CONFIG_BT_MESH_MSG_CACHE_SIZE=1000
# CONFIG_BT_MESH_RPL_STORE_TIMEOUT=1000
# 1000000


# Config for BT Mesh Provisioning
# CONFIG_BT_MESH_PB_ADV=y
CONFIG_BT_MESH_PROVISIONER=y
CONFIG_BT_MESH_CDB=y
CONFIG_BT_MESH_CDB_NODE_COUNT=10
CONFIG_BT_MESH_CDB_SUBNET_COUNT=3
CONFIG_BT_MESH_CDB_APP_KEY_COUNT=3

# Experimental *************
CONFIG_BT_MESH_CDB_ADDR_REISSUE=y

CONFIG_BT_MESH_SUBNET_COUNT=1
CONFIG_BT_MESH_APP_KEY_COUNT=2
CONFIG_BT_MESH_MODEL_GROUP_COUNT=3
CONFIG_BT_MESH_ADV_BUF_COUNT=256
CONFIG_BT_MESH_TX_SEG_MAX=32
CONFIG_BT_MESH_TX_SEG_MSG_COUNT=30
CONFIG_BT_MESH_ADV_BUF_COUNT=120
CONFIG_BT_MESH_SEG_BUFS=120
CONFIG_BT_MESH_RX_SEG_MAX=32
CONFIG_BT_MESH_RX_SEG_MSG_COUNT=30

CONFIG_BT_MESH_LABEL_COUNT=0


# Use Flash Stored BT Mesh Settings
CONFIG_SETTINGS=y
CONFIG_BT_SETTINGS=y
CONFIG_FLASH=y
CONFIG_FLASH_PAGE_LAYOUT=y
CONFIG_FLASH_MAP=y
# Add these to store settings in NVRam
# CONFIG_NVS=y
# CONFIG_FCB=y
# CONFIG_SETTINGS_FCB=y





# Debug and console  Settings
# CONFIG_INIT_STACKS=y
# CONFIG_KERNEL_SHELL=y
# CONFIG_THREAD_STACK_INFO=y
# CONFIG_THREAD_MONITOR=y
# CONFIG_THREAD_NAME=y


# This outputs btmon formatted data to the serial port
# CONFIG_BT_DEBUG_MONITOR=y

# Logging Setttings
CONFIG_LOG=y
# CONFIG_SENSOR_LOG_LEVEL_DBG=y
# CONFIG_LOG_PRINTK=y

# CONFIG_BT_DEBUG_LOG=y
# CONFIG_BT_MESH_DEBUG=y
# CONFIG_BT_MESH_DEBUG_SETTINGS=y
# CONFIG_BT_MESH_DEBUG_CDB=y
# CONFIG_BT_MESH_DEBUG_NET=y
# CONFIG_BT_MESH_DEBUG_MODEL=y
# CONFIG_BT_MESH_DEBUG_TRANS=y
# CONFIG_BT_MESH_DEBUG_ACCESS=y

# CONFIG_BT_MESH_LOW_POWER=y
# CONFIG_BT_MESH_DEBUG_PROV=y
# CONFIG_BT_MESH_DEBUG_LOW_POWER=y
# CONFIG_BT_MESH_DEBUG_BEACON=y
# CONFIG_BT_MESH_DEBUG_CRYPTO=y
# CONFIG_BT_MESH_DEBUG_ADV=y
```

## prj_bbc_microbit.conf
```kconfig
# Change MCUBootloader Build
CONFIG_BOOTLOADER_MCUBOOT=n

CONFIG_ISR_STACK_SIZE=640
CONFIG_MAIN_STACK_SIZE=480
# CONFIG_MAIN_STACK_SIZE=1024
CONFIG_SYSTEM_WORKQUEUE_STACK_SIZE=1024
# CONFIG_SYSTEM_WORKQUEUE_STACK_SIZE=960


# EXPERIMENTAL
CONFIG_DEVICE_POWER_MANAGEMENT=n

# Output Settings
CONFIG_DISPLAY=y
CONFIG_MICROBIT_DISPLAY=y

# Console Settings
# CONFIG_BOOT_DELAY=500
CONFIG_BOOT_BANNER=y
CONFIG_EARLY_CONSOLE=y
CONFIG_STDOUT_CONSOLE=y

# I/O Settings
CONFIG_GPIO=y
CONFIG_I2C=y
CONFIG_SENSOR=y
CONFIG_SPI=n
# CONFIG_PWM=y
# CONFIG_PWM_NRF5_SW=y

# # FXOS8700 Settings
# CONFIG_BT_DISCARDABLE_BUF_COUNT=10
# CONFIG_BT_MESH_RX_SDU_MAX=48
# # CONFIG_BT_MESH_RX_SEG_MSG_COUNT=2
# CONFIG_BT_MESH_ADV_BUF_COUNT=10

CONFIG_FXOS8700=y
CONFIG_FXOS8700_MODE_ACCEL=y
# CONFIG_FXOS8700_RANGE_8G=y
CONFIG_FXOS8700_RANGE_2G=y
# CONFIG_FXOS8700_TRIGGER_OWN_THREAD=y
CONFIG_FXOS8700_TRIGGER_GLOBAL_THREAD=y
CONFIG_FXOS8700_MOTION=y
CONFIG_FXOS8700_PM_LOW_POWER=y
# CONFIG_FXOS8700_MODE_HYBRID=n
# CONFIG_FXOS8700_TEMP=n

# BME280 Settings
CONFIG_BME280=n
# CONFIG_BME280_FILTER_OFF=y

# nRF5x Die Temp Sensor Settings
# CONFIG_TEMP_NRF5=n
# CONFIG_HAS_HW_NRF_TEMP=n

# ADC Settings
# CONFIG_ADC=y
# CONFIG_ADC_0=y
# CONFIG_ADC_NRFX_ADC=y

# CONFIG_ADC_ASYNC=y
# CONFIG_HAS_DTS_ADC=y
# CONFIG_HAS_HW_NRF_ADC=y

# # Watchdog Settings
# CONFIG_WDT_LOG_LEVEL_DBG=y
# CONFIG_WATCHDOG=y


# BT Settings
CONFIG_BT=y
CONFIG_BT_RX_STACK_SIZE=1100
# CONFIG_BT_RX_STACK_SIZE=2048
# CONFIG_BT_RX_STACK_SIZE=2220

CONFIG_BT_CTLR_DUP_FILTER_LEN=0
CONFIG_BT_OBSERVER=y
CONFIG_BT_BROADCASTER=y
CONFIG_BT_PHY_UPDATE=n
CONFIG_BT_DATA_LEN_UPDATE=n

# Use legacy BT Controller
# CONFIG_BT_LL_SW_LEGACY=y


# BT Mesh Settings
CONFIG_BT_MESH=y
CONFIG_BT_MESH_RELAY=n
CONFIG_BT_MESH_PB_ADV=n
CONFIG_BT_MESH_CFG_CLI=y
CONFIG_BT_MESH_HEALTH_CLI=y

CONFIG_BT_MESH_SUBNET_COUNT=1
CONFIG_BT_MESH_APP_KEY_COUNT=2
CONFIG_BT_MESH_MODEL_GROUP_COUNT=2

# # # ADD AND REMOVE FOR SENSOR MEMORY 
# CONFIG_BT_MESH_ADV_BUF_COUNT=32
# CONFIG_BT_MESH_TX_SEG_MAX=12
# CONFIG_BT_MESH_TX_SEG_MSG_COUNT=6
# CONFIG_BT_MESH_RX_SEG_MSG_COUNT=6
# CONFIG_BT_DISCARDABLE_BUF_COUNT=3


# Use Flash Stored BT Mesh Settings
CONFIG_BT_SETTINGS=n
CONFIG_FLASH=y
CONFIG_FLASH_PAGE_LAYOUT=y
CONFIG_FLASH_MAP=y
CONFIG_FCB=y
CONFIG_SETTINGS=y
CONFIG_SETTINGS_FCB=y


## Debugging Settings
CONFIG_LOG=n
# # # CONFIG_BT_LOG_LEVEL=4
# CONFIG_BT_LOG_LEVEL_DBG=y

# # CONFIG_SENSOR_LOG_LEVEL_DBG=y

# CONFIG_BT_DEBUG=y
# CONFIG_BT_DEBUG_LOG=y
# CONFIG_BT_MESH_DEBUG=y
# CONFIG_BT_MESH_DEBUG_SETTINGS=y
# CONFIG_BT_MESH_DEBUG_NET=y
# CONFIG_BT_MESH_DEBUG_MODEL=y
# CONFIG_BT_MESH_DEBUG_TRANS=y
# CONFIG_BT_MESH_SELF_TEST=y
# CONFIG_BT_MESH_IV_UPDATE_TEST=y
# CONFIG_BT_MESH_DEBUG_PROV=y
# CONFIG_BT_MESH_DEBUG_BEACON=y
# CONFIG_BT_MESH_DEBUG_CRYPTO=y
# CONFIG_BT_MESH_DEBUG_ADV=y
# CONFIG_BT_MESH_DEBUG_ACCESS=y
```

## prj_particle_argon.conf
```kconfig
# Need to use the Full New C-Library for maths functions  
CONFIG_NEWLIB_LIBC=y
CONFIG_NEWLIB_LIBC_FLOAT_PRINTF=y
# SNTP Time functions
CONFIG_SNTP=y

CONFIG_JSON_LIBRARY=y

# Memory Settings
# CONFIG_MAIN_STACK_SIZE=4096
CONFIG_SYSTEM_WORKQUEUE_STACK_SIZE=4096
CONFIG_HEAP_MEM_POOL_SIZE=4096
# The Bluetooth API should not be used from a preemptive thread:
# CONFIG_MAIN_THREAD_PRIORITY=-2


# BIG MEMORY 
CONFIG_MAIN_STACK_SIZE=10240
# CONFIG_IDLE_STACK_SIZE=4096
# CONFIG_SYSTEM_WORKQUEUE_STACK_SIZE=10240
# CONFIG_HEAP_MEM_POOL_SIZE=10240

CONFIG_NET_BUF_RX_COUNT=36

CONFIG_HW_STACK_PROTECTION=y
CONFIG_SCHED_MULTIQ=y

# Console Settings
CONFIG_BOOT_BANNER=y
CONFIG_EARLY_CONSOLE=y
CONFIG_STDOUT_CONSOLE=y

# RTT Debugger COMMENT OUT ABOVE
CONFIG_USE_SEGGER_RTT=y
CONFIG_RTT_CONSOLE=y
CONFIG_UART_CONSOLE=n

# I/O and Sensor Settings
CONFIG_GPIO=y
CONFIG_NRFX_GPIOTE=y
CONFIG_I2C=y
CONFIG_SENSOR=y
CONFIG_SPI=n

# nRF5x Die Temp Sensor Settings
CONFIG_TEMP_NRF5=y

# ADC Settings
CONFIG_ADC=y
CONFIG_ADC_ASYNC=y
# CONFIG_ADC_0=y
CONFIG_ADC_NRFX_SAADC=y

# Watchdog Settings
# CONFIG_WDT_LOG_LEVEL_DBG=y
CONFIG_WATCHDOG=y

# BT Settings
CONFIG_BT=y
# CONFIG_BT_RX_BUF_COUNT=30
CONFIG_BT_OBSERVER=y
CONFIG_BT_BROADCASTER=y

# CONFIG_BT_MAX_CONN=20
CONFIG_BT_CTLR_RX_BUFFERS=10
CONFIG_BT_CTLR_ISO_TX_BUFFERS=10
CONFIG_BT_CTLR_ADVANCED_FEATURES=y
# CONFIG_BT_HCI_CMD_COUNT=32
# CONFIG_BT_RX_STACK_SIZE=4096
CONFIG_BT_RX_STACK_SIZE=10240
# CONFIG_BT_CTLR_RX_PRIO_STACK_SIZE=1024
# Improve BT Mesh perforance
# CONFIG_BT_TICKER_LOW_LAT=n
# CONFIG_BT_CTLR_ADVANCED_FEATURES=y
# CONFIG_BT_CTLR_SCAN_UNRESERVED=y

# BT Mesh Settings
CONFIG_BT_MESH=y
CONFIG_BT_MESH_RELAY=n
CONFIG_BT_MESH_CFG_CLI=y
CONFIG_BT_MESH_HEALTH_CLI=y
CONFIG_BT_MESH_BEACON_ENABLED=y
CONFIG_BT_MESH_RELAY_RETRANSMIT_COUNT=3
CONFIG_BT_MESH_LOOPBACK_BUFS=10

CONFIG_BT_TICKER_LOW_LAT=n
CONFIG_BT_CTLR_SCAN_UNRESERVED=y
CONFIG_BT_CTLR_ADVANCED_FEATURES=y

# CONFIG_BT_DEVICE_NAME="Manulytica ARGON"
# CONFIG_BT_PERIPHERAL=y
# CONFIG_BT_CENTRAL=y
# CONFIG_BT_MESH_PB_GATT=y
# CONFIG_BT_MESH_GATT_PROXY=y

# CONFIG_BT_PRIVACY=n
# CONFIG_BT_EXT_ADV=y

# Config for BT Mesh Provisioning
# CONFIG_BT_MESH_PB_ADV=y
CONFIG_BT_MESH_PROVISIONER=y
CONFIG_BT_MESH_PROV_DEVICE=y
CONFIG_BT_MESH_CDB=y
CONFIG_BT_MESH_CDB_NODE_COUNT=20
CONFIG_BT_MESH_CDB_SUBNET_COUNT=3
CONFIG_BT_MESH_CDB_APP_KEY_COUNT=3

# Experimental *************
CONFIG_BT_MESH_CDB_ADDR_REISSUE=y

CONFIG_BT_MESH_SUBNET_COUNT=1
CONFIG_BT_MESH_APP_KEY_COUNT=2
CONFIG_BT_MESH_MODEL_GROUP_COUNT=3
CONFIG_BT_MESH_ADV_BUF_COUNT=256
CONFIG_BT_MESH_TX_SEG_MAX=32
CONFIG_BT_MESH_TX_SEG_MSG_COUNT=30
# CONFIG_BT_MESH_RX_SDU_MAX=120
CONFIG_BT_MESH_ADV_BUF_COUNT=120
CONFIG_BT_MESH_SEG_BUFS=120
CONFIG_BT_MESH_RX_SEG_MAX=32
CONFIG_BT_MESH_RX_SEG_MSG_COUNT=30

CONFIG_BT_MESH_LABEL_COUNT=0

# Mesh Replay Buffer Controls
CONFIG_BT_MESH_CRPL=1024
CONFIG_BT_MESH_MSG_CACHE_SIZE=2048
CONFIG_BT_MESH_RPL_STORE_TIMEOUT=500000 
# CONFIG_BT_MESH_RPL_STORE_TIMEOUT=1000000

# Use Flash Stored BT Mesh Settings
CONFIG_SETTINGS=y
CONFIG_BT_SETTINGS=y
CONFIG_FLASH=y
CONFIG_FLASH_PAGE_LAYOUT=y
CONFIG_FLASH_MAP=y
# Add for external Flash memory (MX25L1606)
CONFIG_FLASH=y
CONFIG_SPI=y
CONFIG_SPI_NOR=y
# Add these to store settings in NVRam
CONFIG_NVS=y
CONFIG_FCB=y
CONFIG_SETTINGS_FCB=y

# Modem Setting (ESP8266)
CONFIG_WIFI=y
CONFIG_WIFI_ESP_AT=y
CONFIG_WIFI_ESP_AT_RX_STACK_SIZE=10240
CONFIG_WIFI_ESP_AT_MDM_RX_BUF_SIZE=512
CONFIG_WIFI_ESP_AT_MDM_RING_BUF_SIZE=10240
# CONFIG_SHELL_BACKEND_SERIAL_TX_RING_BUFFER_SIZE=10
# CONFIG_WIFI_ESP8266=y

CONFIG_WIFI_SSID="BillyBobJoe2G"
CONFIG_WIFI_PASSWORD="Noyoucantbu5ter"

CONFIG_NETWORKING=y
CONFIG_NET_SOCKETS_POSIX_NAMES=y
# CONFIG_NET_OFFLOAD=y
# CONFIG_NET_SOCKETS=y

# CONFIG_NET_SHELL=y
# CONFIG_NET_STATISTICS=y
# CONFIG_NET_STATISTICS_PERIODIC_OUTPUT=n


# # Modem Setting (ESP32)
# CONFIG_NETWORKING=y
# CONFIG_NET_OFFLOAD=y

# # Enable Sockets support
CONFIG_NET_SOCKETS=y
# CONFIG_NET_SOCKETS_SOCKOPT_TLS=y

# CONFIG_NET_SOCKETS_OFFLOAD=y
# CONFIG_NET_SOCKETS_OFFLOAD_TLS=y

# CONFIG_WIFI=y

# CONFIG_SHELL=y
# CONFIG_NET_SHELL=y
# CONFIG_NET_L2_WIFI_MGMT=y
# CONFIG_NET_L2_WIFI_SHELL=y

# CONFIG_WIFI_ESP32=y
# # CONFIG_WIFI_ESP32_GPIO_ENABLE_PIN=16
# # CONFIG_WIFI_ESP32_HAS_ENABLE_PIN=y


# Hack: disable IPv6 for now
# Enable IPv6 support
CONFIG_NET_IPV6=n
CONFIG_NET_CONFIG_NEED_IPV6=n

# Enable IPv4 support
CONFIG_NET_IPV4=y
CONFIG_NET_TCP=y
# CONFIG_NET_UDP=y

# Enable the MQTT Lib
CONFIG_MQTT_LIB=y
# CONFIG_MQTT_KEEPALIVE=240

# MQTT Connection Settings
CONFIG_NET_CONFIG_SETTINGS=n
# CONFIG_NET_CONFIG_MY_IPV6_ADDR="2001:db8::1"
# CONFIG_NET_CONFIG_PEER_IPV6_ADDR="2001:db8::2"

# CONFIG_NET_CONFIG_MY_IPV4_ADDR="192.168.0.123"
# CONFIG_NET_CONFIG_PEER_IPV4_ADDR="158.176.104.27"  #  v93xbs.messaging.internetofthings.ibmcloud.com
# CONFIG_NET_CONFIG_MY_IPV4_GW="192.168.0.1"

# CONFIG_NET_CONFIG_MY_IPV4_ADDR="192.168.0.201"
# CONFIG_NET_CONFIG_PEER_IPV4_ADDR="52.7.124.212"   # "io.adafruit.com"
# CONFIG_NET_CONFIG_PEER_IPV4_ADDR="37.187.106.16"  # test.mosquitto.org
# CONFIG_NET_CONFIG_PEER_IPV4_ADDR="192.168.0.35"  # RPi mosquitto.org



# Network connection manager
# CONFIG_NET_CONNECTION_MANAGER=y

# CONFIG_NET_MGMT_EVENT_STACK_SIZE=4096
# CONFIG_NET_MGMT_EVENT_QUEUE_SIZE=512
# CONFIG_NET_MGMT_EVENT_LOG_LEVEL_DBG=n

CONFIG_DNS_RESOLVER=y
CONFIG_DNS_SERVER_IP_ADDRESSES=y
CONFIG_DNS_SERVER1="8.8.8.8"
CONFIG_DNS_RESOLVER_ADDITIONAL_BUF_CTR=2


# Debug and console  Settings
# CONFIG_INIT_STACKS=y
# CONFIG_THREAD_STACK_INFO=y
# CONFIG_THREAD_MONITOR=y
# CONFIG_KERNEL_SHELL=y
# CONFIG_THREAD_NAME=y

# Logging Setttings
CONFIG_LOG=n
CONFIG_LOG_BUFFER_SIZE=4086
# # # CONFIG_LOG_DEFAULT_LEVEL=4
# # # CONFIG_NET_LOG=y
# CONFIG_WIFI_LOG_LEVEL_DBG=y
# # CONFIG_MODEM_LOG_LEVEL_INF=y
# CONFIG_MODEM_LOG_LEVEL_DBG=y
# CONFIG_MODEM_CONTEXT_VERBOSE_DEBUG=y 

# CONFIG_NET_L2_WIFI_SHELL=y

# CONFIG_NET_TCP_LOG_LEVEL_DBG=y
# CONFIG_NET_CONTEXT_LOG_LEVEL_DBG=y
# CONFIG_MQTT_LOG_LEVEL_DBG=y




# This outputs btmon formatted data to the serial port
# CONFIG_BT_DEBUG_MONITOR=y

# CONFIG_BT_DEBUG_LOG=y
# CONFIG_BT_LOG_LEVEL_DBG=y
# CONFIG_BT_MESH_DEBUG=y
# CONFIG_BT_MESH_DEBUG_SETTINGS=y
# CONFIG_BT_MESH_DEBUG_NET=y
# CONFIG_BT_MESH_DEBUG_MODEL=y
# CONFIG_BT_MESH_DEBUG_TRANS=y
# CONFIG_BT_MESH_DEBUG_ACCESS=y

# CONFIG_BT_MESH_LOW_POWER=y
# CONFIG_BT_MESH_DEBUG_PROV=y
# CONFIG_BT_MESH_DEBUG_LOW_POWER=y
# CONFIG_BT_MESH_DEBUG_BEACON=y
# CONFIG_BT_MESH_DEBUG_CRYPTO=y
# CONFIG_BT_MESH_DEBUG_ADV=y
```

## prj_particle_boron - Copy.conf
```kconfig
# Need to use the Full New C-Library for maths functions  
CONFIG_NEWLIB_LIBC=y
CONFIG_NEWLIB_LIBC_FLOAT_PRINTF=y
# SNTP Time functions
CONFIG_SNTP=y

# Memory Settings
CONFIG_MAIN_STACK_SIZE=4096
CONFIG_SYSTEM_WORKQUEUE_STACK_SIZE=4096
CONFIG_HEAP_MEM_POOL_SIZE=4096

CONFIG_NET_BUF_RX_COUNT=64

CONFIG_HW_STACK_PROTECTION=y
CONFIG_SCHED_MULTIQ=y

# Console Settings
CONFIG_BOOT_BANNER=y
CONFIG_EARLY_CONSOLE=y
CONFIG_STDOUT_CONSOLE=y

# RTT Debugger COMMENT OUT ABOVE
CONFIG_USE_SEGGER_RTT=y
CONFIG_RTT_CONSOLE=y
CONFIG_UART_CONSOLE=n

# I/O and Sensor Settings
CONFIG_GPIO=y
CONFIG_NRFX_GPIOTE=y
CONFIG_I2C=y
CONFIG_SENSOR=y
CONFIG_SPI=n

# nRF5x Die Temp Sensor Settings
CONFIG_TEMP_NRF5=y

# ADC Settings
CONFIG_ADC=y
CONFIG_ADC_ASYNC=y
# CONFIG_ADC_0=y
CONFIG_ADC_NRFX_SAADC=y

# Watchdog Settings
# CONFIG_WDT_LOG_LEVEL_DBG=y
CONFIG_WATCHDOG=y

# BT Settings
CONFIG_BT=y
# CONFIG_BT_RX_BUF_COUNT=30
CONFIG_BT_OBSERVER=y
CONFIG_BT_BROADCASTER=y

# CONFIG_BT_MAX_CONN=1
# CONFIG_BT_CTLR_RX_BUFFERS=10
# CONFIG_BT_CTLR_TX_BUFFERS=10
CONFIG_BT_CTLR_ADVANCED_FEATURES=y
# CONFIG_BT_CTLR_JOB_PRIO=1
CONFIG_BT_HCI_CMD_COUNT=4
CONFIG_BT_RX_STACK_SIZE=4096
# CONFIG_BT_HCI_TX_STACK_SIZE=1024

# BT Mesh Settings
CONFIG_BT_MESH=y
CONFIG_BT_MESH_RELAY=y
CONFIG_BT_MESH_CFG_CLI=y
CONFIG_BT_MESH_HEALTH_CLI=y


# Config for BT Mesh Provisioning
# CONFIG_BT_MESH_PB_ADV=y
CONFIG_BT_MESH_PROVISIONER=y
CONFIG_BT_MESH_CDB=y
CONFIG_BT_MESH_CDB_NODE_COUNT=20
CONFIG_BT_MESH_CDB_SUBNET_COUNT=3
CONFIG_BT_MESH_CDB_APP_KEY_COUNT=3

# Experimental *************
CONFIG_BT_MESH_CDB_ADDR_REISSUE=y

CONFIG_BT_MESH_SUBNET_COUNT=1
CONFIG_BT_MESH_APP_KEY_COUNT=2
CONFIG_BT_MESH_MODEL_GROUP_COUNT=3
CONFIG_BT_MESH_ADV_BUF_COUNT=256
CONFIG_BT_MESH_TX_SEG_MAX=32
CONFIG_BT_MESH_TX_SEG_MSG_COUNT=30
# CONFIG_BT_MESH_RX_SDU_MAX=120
CONFIG_BT_MESH_ADV_BUF_COUNT=120
CONFIG_BT_MESH_SEG_BUFS=120
CONFIG_BT_MESH_RX_SEG_MAX=32
CONFIG_BT_MESH_RX_SEG_MSG_COUNT=30

CONFIG_BT_MESH_LABEL_COUNT=0

# Mesh Replay Buffer Controls
CONFIG_BT_MESH_CRPL=4096
CONFIG_BT_MESH_MSG_CACHE_SIZE=4096
CONFIG_BT_MESH_RPL_STORE_TIMEOUT=500000 
# CONFIG_BT_MESH_RPL_STORE_TIMEOUT=1000000

# Use Flash Stored BT Mesh Settings
CONFIG_SETTINGS=y
CONFIG_BT_SETTINGS=y
CONFIG_FLASH=y
CONFIG_FLASH_PAGE_LAYOUT=y
CONFIG_FLASH_MAP=y
# Add these to store settings in NVRam
CONFIG_NVS=y
CONFIG_FCB=y
CONFIG_SETTINGS_FCB=y


# Modem Setting (UBlox R4 or U2)
CONFIG_MODEM=y
CONFIG_MODEM_SHELL=y
CONFIG_MODEM_UBLOX_SARA_U2=y
# CONFIG_MODEM_UBLOX_SARA=y

CONFIG_NETWORKING=y
CONFIG_NET_SOCKETS_POSIX_NAMES=y
CONFIG_NET_SOCKETS=y
CONFIG_NET_OFFLOAD=y
CONFIG_NET_SOCKETS_OFFLOAD=y


# Hack: disable IPv6 for now
# Enable IPv6 support
CONFIG_NET_IPV6=n
CONFIG_NET_CONFIG_NEED_IPV6=n

# Enable IPv4 support
CONFIG_NET_IPV4=y
CONFIG_NET_TCP=y
# CONFIG_NET_UDP=y


# Enable the MQTT Lib
CONFIG_MQTT_LIB=y
CONFIG_MQTT_KEEPALIVE=240



##################### TEST ETHERNET ###############
# CONFIG_MQTT_LIB_TLS=y
# CONFIG_NET_SOCKETS_SOCKOPT_TLS=y

# # TLS configuration
# CONFIG_MBEDTLS=y
# CONFIG_MBEDTLS_BUILTIN=y
# CONFIG_MBEDTLS_ENABLE_HEAP=y
# CONFIG_MBEDTLS_HEAP_SIZE=30000
# CONFIG_MBEDTLS_SSL_MAX_CONTENT_LEN=2048



CONFIG_NET_CONFIG_SETTINGS=y
# CONFIG_NET_CONFIG_MY_IPV6_ADDR="2001:db8::1"
# CONFIG_NET_CONFIG_PEER_IPV6_ADDR="2001:db8::2"

CONFIG_NET_CONFIG_MY_IPV4_ADDR="192.168.0.123"
CONFIG_NET_CONFIG_PEER_IPV4_ADDR="158.176.104.27"  #  v93xbs.messaging.internetofthings.ibmcloud.com
CONFIG_NET_CONFIG_MY_IPV4_GW="192.168.0.1"

# "158.176.104.27"  #  v93xbs.messaging.internetofthings.ibmcloud.com
# "158.175.111.154" //"v93xbs.internetofthings.ibmcloud.com"
# "169.46.7.59" //"quickstart.messaging.internetofthings.ibmcloud.com"

##################### TEST ETHERNET ###############



# Debug and console  Settings
# CONFIG_INIT_STACKS=y
# CONFIG_THREAD_STACK_INFO=y
# CONFIG_THREAD_MONITOR=y
# CONFIG_KERNEL_SHELL=y
# CONFIG_THREAD_NAME=y



# Logging Setttings
CONFIG_LOG=y
# CONFIG_LOG_DEFAULT_LEVEL= 4
# CONFIG_MODEM_LOG_LEVEL_INF=y
CONFIG_MODEM_LOG_LEVEL_DBG=y
CONFIG_MODEM_CONTEXT_VERBOSE_DEBUG=y 


# # CONFIG_KERNEL_LOG_LEVEL_DBG=y
# CONFIG_NET_LOG=y
# CONFIG_NET_OFFLOAD_LOG_LEVEL_DBG=y

# This outputs btmon formatted data to the serial port
# CONFIG_BT_DEBUG_MONITOR=y

# CONFIG_BT_DEBUG=y
# CONFIG_BT_DEBUG_LOG=y
# CONFIG_BT_MESH_DEBUG=y
# CONFIG_BT_MESH_DEBUG_SETTINGS=y
# CONFIG_BT_MESH_DEBUG_NET=y
# CONFIG_BT_MESH_DEBUG_MODEL=y
# CONFIG_BT_MESH_DEBUG_TRANS=y
# CONFIG_BT_MESH_DEBUG_ACCESS=y

# CONFIG_BT_MESH_LOW_POWER=y
# CONFIG_BT_MESH_DEBUG_PROV=y
# CONFIG_BT_MESH_DEBUG_LOW_POWER=y
# CONFIG_BT_MESH_DEBUG_BEACON=y
# CONFIG_BT_MESH_DEBUG_CRYPTO=y
# CONFIG_BT_MESH_DEBUG_ADV=y
```

## src/adc_sensor.c
```c
/*
 * Copyright (c) 2019 Manulytica Ltd
 *
 * SPDX-License-Identifier: Apache-2.0
 */


/** @file
 *  @brief ADC Sensor with Mesh Sensor Setup Model Functions
 */
#include <zephyr.h>
#include <drivers/adc.h>
#include <math.h>

#include <hal/nrf_saadc.h>

#include "mesh.c"
#include "adc_sensor.h"


/* see PR #21606 */
struct io_channel_config {
	const char *label;
	uint8_t channel;
};

struct gpio_channel_config {
	const char *label;
	uint8_t pin;
	uint8_t flags;
};

struct divider_config {
	const struct io_channel_config io_channel;
	const struct gpio_channel_config power_gpios;
	/* output_ohm is used as a flag value: if it is nonzero then
	 * the battery is measured through a voltage divider;
	 * otherwise it is assumed to be directly connected to Vdd.
	 */	
	const uint32_t output_ohm;
	const uint32_t full_ohm;
};

// static const struct divider_config divider_config = {
// 	// .io_channel = DT_VOLTAGE_DIVIDER_EXTSENSOR_IO_CHANNELS,
// 	.io_channel = DT_NODE_HAS_PROP(DT_INST(0, extsensor), io_channels)
// 	/* TODO: */
// 	/* Hardcoded for the moment */
// 	// .io_channel = 0x03,
// #ifdef DT_VOLTAGE_DIVIDER_EXTSENSOR_POWER_GPIOS
// 	// .power_gpios = DT_VOLTAGE_DIVIDER_EXTSENSOR_POWER_GPIOS,
// 	.power_gpios= DT_NODE_HAS_PROP(DT_INST(0, extsensor), power_gpios)
// #endif
// 	.output_ohm = DT_VOLTAGE_DIVIDER_EXTSENSOR_OUTPUT_OHMS,
// 	// .output_ohm = DT_NODE_HAS_PROP(DT_INST(0, extsensor), output_ohm)
// 	.full_ohm = DT_VOLTAGE_DIVIDER_EXTSENSOR_FULL_OHMS,
// 	// .full_ohm = DT_NODE_HAS_PROP(DT_INST(0, extsensor), full_ohm)
// };

static const struct divider_config divider_config = {
#if DT_NODE_HAS_STATUS(EXTSENSOR, okay)
	.io_channel = {
		DT_IO_CHANNELS_LABEL(EXTSENSOR),
		DT_IO_CHANNELS_INPUT(EXTSENSOR),
	},
#if DT_NODE_HAS_PROP(VBATT, power_gpios)
	.power_gpios = {
		DT_GPIO_LABEL(EXTSENSOR, power_gpios),
		DT_GPIO_PIN(EXTSENSOR, power_gpios),
		DT_GPIO_FLAGS(EXTSENSOR, power_gpios),
	},
#endif
	.output_ohm = DT_PROP(EXTSENSOR, output_ohms),
	.full_ohm = DT_PROP(EXTSENSOR, full_ohms),
#else /* EXTSENSOR dont exists */
	.io_channel = {
		DT_LABEL(DT_ALIAS(adc_0)),
	},
#endif /* /EXTSENSOR exists */
};

/* create sample holder */
float last_sample = 0.0;
int ii = 0;


static void ext_value_convert(struct sensor_value *val, int16_t raw)
{
	int32_t value;

	/* Convert units to micro Gauss. Raw magnetic data always has a
	 * resolution of 0.1 uT/LSB, which is equivalent to 0.001 G/LSB. */
	value = raw;

	val->val1 = value ;
	val->val2 = value % value;
}


/** Configure ADC thread worker  **/
static struct k_work adc_gpio_work;


/** Configure the ADC PIN for GPIO (button) reading **/
static uint32_t adc_gpio_read(const struct device *port, uint32_t pin)
{
	// uint32_t val = 0U;

	// gpio_pin_get_raw(port, pin, &val);
	// return val;

	return gpio_pin_get_raw(port, pin);
}

static void gpio_trigger_handler(struct k_work *work)
{
	/* Send unsolicited message of sensor readings */
	if (adc_gpio_read(adc_dev, 0x03) == 0) {
		/* TODO: Increase counter value.... */
		printk("PUSHED THE BUTTON ---- : %d \n", ii);
		send_sensor_data(SENS_PROP_ID_TEMP); // CPU Die Temperature (C)
		send_sensor_data(
			SENS_PROP_ID_COUNTER); // Ext Item Detected (Increment count total)

		// // Increment the item counter
		// ext_item_count++;

		// /* Reset counter at 65000 dec */
		// if (ext_item_count > 0xfde8) { // 0xfde8
		// 	ext_item_count = 1; 
		// }	

		if (ii++ > 10)
		{
			adc_cadence_data.property_id = SENS_PROP_ID_EXT_TEMP;
			// init_adc();
			adc_reset();
		}		
    }

}

static void gpio_triggered(const struct device *dev,
			   struct gpio_callback *cb, unsigned int pins)
// static void gpio_triggered(struct device *dev,
// 			   struct gpio_callback *cb, uint32_t pins)
{
	k_work_submit(&adc_gpio_work);
}




/*******************************************************************************
 * Calibrate ADC Inputs 
 */
int adc_calibrate(void)
{
	int ret = 0U;
	const struct adc_sequence sequence = {
		.channels = BIT(ADC_1ST_CHANNEL_ID),
		// .buffer = adc_sample_buffer,
		// .buffer_size = sizeof(adc_sample_buffer),
		// .resolution = ADC_RESOLUTION,
		.calibrate = 0b1,
	};

	if (!adc_dev) {
		printk("ERROR: Device not found - ADC DEVICE %s \n", ADC_DEVICE_NAME);
        return ret;
	}

	ret = adc_read(adc_dev, &sequence);
	if (ret != 0) {
		printk("adc_read() failed with code %d", ret);
		return ret;
	}	

	return ret;
}


/*******************************************************************************
 * Initaise the ADC Device based on candence Property ID ie counter or not
 */
static int init_adc(void)
{
	int ret = 0U;

	adc_dev = device_get_binding("NULL");

	if (!adc_dev) {
		printk("ERROR: ADC Device not found EMPTY \n");
	}	


	/* Add function to update the Sensor sensor_property_ids */
	struct net_buf_simple buf;
	net_buf_simple_init(&buf, 0);
	// net_buf_simple_add_le16(&buf, SENS_PROP_ID_COUNTER);

	sensor_property_ids.sensor_property_id = adc_cadence_data.property_id;
	sensor_property_ids.sensor_setting_property_ids =  &buf;



	switch (adc_cadence_data.property_id)
	{
	case SENS_PROP_ID_COUNTER :
	case SENS_PROP_ID_EXT_CNT_TOTAL :
		/* code */
		printf("GPIO CONTROLLER \n");
		
		k_work_init(&adc_gpio_work, gpio_trigger_handler);

		// static struct gpio_callback adc_gpio_cb;

		// adc_dev = device_get_binding(DT_ALIAS_SW0_GPIOS_CONTROLLER);

		// if (!adc_dev) {
		// 	printk("ERROR: Device not found - GPIOS_CONTROLLER DEVICE %s \n", DT_ALIAS_SW0_GPIOS_CONTROLLER);
		// 	return ret;
		// }

		// gpio_pin_configure(adc_dev, 0x03,
		// 		GPIO_INPUT | DT_ALIAS_SW0_GPIOS_FLAGS);
		// gpio_pin_interrupt_configure(
		// 	adc_dev, 0x03,
		// 	GPIO_PULL_UP | GPIO_INT_DEBOUNCE |
		// 		GPIO_INT_LOW_0 | GPIO_INT_EDGE_TO_ACTIVE);

		// // gpio_pin_configure(adc_dev, 0x03,
		// // 		(GPIO_INPUT | GPIO_INT | GPIO_INT_EDGE |
		// // 			GPIO_PULL_UP |
		// // 			GPIO_INT_DEBOUNCE | GPIO_INT_LOW_0));
		// gpio_init_callback(&adc_gpio_cb, gpio_triggered, BIT(0x03));
		// gpio_add_callback(adc_dev, &adc_gpio_cb);
		// // gpio_pin_enable_callback(adc_dev, 0x03);



		adc_dev = device_get_binding(DT_GPIO_LABEL(DT_ALIAS(sw0), gpios));

		if (!adc_dev) {
			printk("ERROR: Device not found - GPIOS_CONTROLLER DEVICE %s \n", (DT_GPIO_LABEL(DT_ALIAS(sw0), gpios)));
			return ret;
		}
		
		gpio_pin_configure(adc_dev, 0x03,
				GPIO_INPUT | DT_GPIO_FLAGS(DT_ALIAS(sw0), gpios));
		gpio_pin_interrupt_configure(adc_dev, 0x03,
						GPIO_PULL_UP | GPIO_INT_DEBOUNCE |
							GPIO_INT_LOW_0 |
							GPIO_INT_EDGE_TO_ACTIVE);

		gpio_init_callback(&adc_gpio_cb, gpio_triggered,BIT(0x03));
		gpio_add_callback(adc_dev, &adc_gpio_cb);

		/* Add function to update the Sensor sensor_property_ids */
		// net_buf_simple_add_le16(&buf, SENS_PROP_ID_COUNTER);
		sensor_property_ids.sensor_setting_property_ids =  &buf;

		break;
	
	default: /* Use ADC to read input */
		printf("ADC_DEVICE \n");

		adc_dev = device_get_binding(ADC_DEVICE_NAME);

		if (!adc_dev) {
			printk("ERROR: Device not found - ADC DEVICE %s \n", ADC_DEVICE_NAME);
			return ret;
		}

		ret = adc_channel_setup(adc_dev, &adc_1st_channel_cfg);

		if (ret != 0) {
			printk("Setting up of the first channel failed with code %d", ret);
			return ret;
		}

#if defined(ADC_2ND_CHANNEL_ID)
		ret = adc_channel_setup(adc_dev, &adc_2nd_channel_cfg);
		if (ret != 0) {
			printk("Setting up of the second channel failed with code %d", ret);
			return ret;
		}		
#endif /* defined(ADC_2ND_CHANNEL_ID) */

		adc_calibrate();

		(void)memset(adc_sample_buffer, 0, sizeof(adc_sample_buffer));

		/* Update the Sensor sensor_property_ids */
		// net_buf_simple_add_le16(&buf, SENS_PROP_ID_COUNTER);
		sensor_property_ids.sensor_setting_property_ids =  &buf;

		/* If no errors define/initialise adc Cadence data */
		printk("Setting Cadence Data....\n\n");

		/* TODO: Set the defaults in Header File */
		// adc_cadence_data.property_id = SENS_PROP_ID_EXT_TEMP;

		adc_cadence_data.fast_cadence_low.val1 = -14.0;
		adc_cadence_data.fast_cadence_low.val2 = 00;
		adc_cadence_data.fast_cadence_high.val1 = 100.0;
		adc_cadence_data.fast_cadence_high.val2 = 00;
		adc_cadence_data.status_trigger_delta_down.val1 = -5000;
		adc_cadence_data.status_trigger_delta_down.val2 = 0;
		adc_cadence_data.status_trigger_delta_up.val1 = 5000;
		adc_cadence_data.status_trigger_delta_up.val2 = 0;
		adc_cadence_data.status_trigger_type = 0b1;

		break;
	}

	return ret;
}



/** The rest function will change the ADC sensor cadence settings and 
 * the sensor TYPE, ie Counter, Pressure, Temperature, etc..
 * 
 **/
static int adc_reset(void)
{
	int ret = 0U;

	// adc_dev = device_get_binding("NULL");

	// if (!adc_dev) {
	// 	printk("ERROR: ADC Device not found EMPTY \n");
	// }	

	switch (adc_cadence_data.property_id)
	{
	case SENS_PROP_ID_COUNTER :
	case SENS_PROP_ID_EXT_CNT_TOTAL :

		printf("GPIO CONTROLLER \n");
		/* RESET COUNTER */
		ii = 0;

		/* unconfigure ADC Channels */
		ret = adc_channel_setup(adc_dev, &adc_empty_channel_cfg);
		if (ret != 0) {
			printk("No channel set-up %d", ret);
		}		

		// adc_dev = device_get_binding(DT_ALIAS_SW0_GPIOS_CONTROLLER);

		// if (!adc_dev) {
		// 	printk("ERROR: Device not found - GPIOS_CONTROLLER DEVICE %s \n", DT_ALIAS_SW0_GPIOS_CONTROLLER);
		// 	return ret;
		// }

		// gpio_pin_configure(adc_dev, 0x03,
		// 		GPIO_INPUT | DT_ALIAS_SW0_GPIOS_FLAGS);
		// gpio_pin_interrupt_configure(
		// 	adc_dev, 0x03,
		// 	GPIO_PULL_UP | GPIO_INT_DEBOUNCE |
		// 		GPIO_INT_LOW_0 | GPIO_INT_EDGE_TO_ACTIVE);


		// // gpio_pin_configure(adc_dev, 0x03,
		// // 		(GPIO_INPUT | GPIO_INT | GPIO_INT_EDGE |
		// // 			GPIO_PULL_UP |
		// // 			GPIO_INT_DEBOUNCE | GPIO_INT_LOW_0));
		// gpio_init_callback(&adc_gpio_cb, gpio_triggered, BIT(0x03));
		// gpio_add_callback(adc_dev, &adc_gpio_cb);
		// // gpio_pin_enable_callback(adc_dev, 0x03);		

		adc_dev = device_get_binding(DT_GPIO_LABEL(DT_ALIAS(sw0), gpios));

		if (!adc_dev) {
			printk("ERROR: Device not found - GPIOS_CONTROLLER DEVICE %s \n", (DT_GPIO_LABEL(DT_ALIAS(sw0), gpios)));
			return ret;
		}
		
		gpio_pin_configure(adc_dev, 0x03,
				GPIO_INPUT | DT_GPIO_FLAGS(DT_ALIAS(sw0), gpios));
		gpio_pin_interrupt_configure(adc_dev, 0x03,
						GPIO_PULL_UP | GPIO_INT_DEBOUNCE |
							GPIO_INT_LOW_0 |
							GPIO_INT_EDGE_TO_ACTIVE);

		gpio_init_callback(&adc_gpio_cb, gpio_triggered,BIT(0x03));
		gpio_add_callback(adc_dev, &adc_gpio_cb);
		break;
	
	default: /* Use ADC to read input */
		printf("ADC_DEVICE \n");

		/* Disable GPIO Callback */
		// gpio_pin_disable_callback(adc_dev, 0x03);
		gpio_pin_interrupt_configure(adc_dev, 0x03, GPIO_INT_DISABLE);


		adc_dev = device_get_binding(ADC_DEVICE_NAME);
		if (!adc_dev) {
			printk("ERROR: Device not found - ADC DEVICE %s \n", ADC_DEVICE_NAME);
			return ret;
		}

		ret = adc_channel_setup(adc_dev, &adc_1st_channel_cfg);
		if (ret != 0) {
			printk("Setting up of the first channel failed with code %d", ret);
			return ret;
		}

	#if defined(ADC_2ND_CHANNEL_ID)
		ret = adc_channel_setup(adc_dev, &adc_2nd_channel_cfg);
		if (ret != 0) {
			printk("Setting up of the second channel failed with code %d", ret);
			return ret;
		}		
	#endif /* defined(ADC_2ND_CHANNEL_ID) */

		(void)memset(adc_sample_buffer, 0, sizeof(adc_sample_buffer));

		/* If no errors define/initialise adc Cadence data */
		printk("Setting Cadence Data....\n\n");

		/* TODO: Set the defaults in Header File */
		// adc_cadence_data.property_id = SENS_PROP_ID_EXT_TEMP;

		adc_cadence_data.fast_cadence_low.val1 = -14.0;
		adc_cadence_data.fast_cadence_low.val2 = 00;

		adc_cadence_data.fast_cadence_high.val1 = 100.0;
		adc_cadence_data.fast_cadence_high.val2 = 00;

		adc_cadence_data.status_trigger_delta_down.val1 = -5000;
		adc_cadence_data.status_trigger_delta_down.val2 = 0;

		adc_cadence_data.status_trigger_delta_up.val1 = 5000;
		adc_cadence_data.status_trigger_delta_up.val2 = 0;

		adc_cadence_data.status_trigger_type = 0b1;

		break;
	}

	return ret;
}





static void check_samples(int expected_count)
{

}




/*******************************************************************************
 * read adc_sample_one_channel
 */
int read_channel_one(void)
{

	printf("read_channel_one \n");

	int ret = 0U;
	const struct adc_sequence sequence = {
		.channels    = BIT(ADC_1ST_CHANNEL_ID),
		.buffer      = adc_sample_buffer,
		.buffer_size = sizeof(adc_sample_buffer),
		.resolution  = ADC_RESOLUTION,
	};

	if (!adc_dev) {
		printk("ERROR: Device not found - ADC DEVICE %s \n", ADC_DEVICE_NAME);
        return ret;
	}

	ret = adc_read(adc_dev, &sequence);
	if (ret != 0) {
		printk("adc_read() failed with code %d", ret);
		return ret;
	}	

	check_samples(1);

	return ret;
}


/*******************************************************************************
 * read adc_sample_two_channels
 */
int read_channel_two(void)
{
	int ret = 0U;

	printf("read_channel_two \n");


#if !defined(ADC_2ND_CHANNEL_ID)
    printk("adc_read() ADC_2ND_CHANNEL_ID not set");
    return -EINVAL;

#else
	const struct adc_sequence sequence = {
		// .channels    = BIT(ADC_1ST_CHANNEL_ID) |
		// 	       BIT(ADC_2ND_CHANNEL_ID),
		.channels    = BIT(ADC_2ND_CHANNEL_ID),				   
		.buffer      = adc_sample_buffer,
		.buffer_size = sizeof(adc_sample_buffer),
		.resolution  = ADC_RESOLUTION,
	};




	if (!adc_dev) {
		return ret;
	}

	ret = adc_read(adc_dev, &sequence);
	if (ret != 0) {
		printk("adc_read() failed with code %d", ret);
		return ret;
	}	

	// check_samples(2);
	check_samples(1);
#endif

	return ret;
}




/*******************************************************************************
 * test_adc_sample_with_interval
 */
// static enum adc_action adc_sampling_callback(
// 				const struct device *dev,
// 				const struct adc_sequence *sequence,
// 				uint16_t sampling_index)
// {
// 	// printk("%s: sampling %d\n", __func__, sampling_index);
// 	return ADC_ACTION_CONTINUE;
// }

int adc_sensor_sampling(void)
{
	int ret = 0U;
	struct adc_sequence_options options = {
		.interval_us     = 300 * 1000UL,
		.callback        = adc_sampling_callback,
		.extra_samplings = ADC_BUFFER_SIZE - 1,
	};


	if (!adc_dev) {
		return -1;
	}

#if !defined(ADC_2ND_CHANNEL_ID) 
	const struct adc_sequence sequence = {
		.options     = &options,
		.channels    = BIT(ADC_1ST_CHANNEL_ID),
		.buffer      = adc_sample_buffer,
		.buffer_size = sizeof(adc_sample_buffer),
		.resolution  = ADC_RESOLUTION,
	};

	ret = adc_read(adc_dev, &sequence);
	int channels = 1;
#else
	const struct adc_sequence sequence = {
		.options     = &options,	
		.channels    = BIT(ADC_2ND_CHANNEL_ID),
		.buffer      = adc_sample_buffer,
		.buffer_size = sizeof(adc_sample_buffer),
		.resolution  = ADC_RESOLUTION,
	};
	int channels = 1;
	ret = adc_read(adc_dev, &sequence);
#endif
	if (ret != 0) {
		printk("adc_read() failed with code %d \n", ret);
		return ret;
	}	

	check_samples(channels + options.extra_samplings);

	return ret;
}


/**  External function to return sensor value  **/
void external_get_value(uint16_t property_id,struct sensor_value *sensor_value)
{
	/* Use Global Device (dev) */
	if (adc_dev == NULL) {
		printf("ERROR: Could not get external sensor device\n");
		return;
	}

	if (adc_cadence_data.property_id == SENS_PROP_ID_COUNTER)
	{
		// sensor_value->val1 = ext_item_count;
		// printk("Counter ID : %d\n", sensor_value->val1);
		// return;
		printk("Counter ID \n");
		return;
	}
	/* Take a semaphor flag */
	// k_sem_take(&sem, K_NO_WAIT);

#if !defined(ADC_2ND_CHANNEL_ID) 
	if (read_channel_one()){
		printf("ERROR: Could not read external sensor device\n");
		return;
	}
#else
	if (read_channel_two()){
		printf("ERROR: Could not read external sensor device\n");
		return;
	}

#endif

	int reading_val;
	float in_min, in_max, out_min, out_max;
	reading_val = adc_sample_buffer[0];
	in_min = 0U;
	out_min = -10;
	in_max = 4095;
	out_max = 1000;

	/* Create divisor structure */
	const struct divider_config *dcp = &divider_config;
	int32_t val = reading_val;
	
	printk("Converting to mV \n");

	adc_raw_to_millivolts(adc_ref_internal(adc_dev),
				ADC_GAIN,
				ADC_RESOLUTION,
				&val);
	int32_t reading_volts = val * (uint64_t)dcp->full_ohm / dcp->output_ohm;
	




	float step_coeficient = (float)(out_max - out_min) / ADC_REF_VOLTAGE_IN_MILLIVOLTS ;
	// float reading_volts = (((reading_val * ADC_REF_VOLTAGE_IN_MILLIVOLTS) / (ADC_RES_12BIT -1)) * 1);
	// float reading_volts = ADC_RESULT_IN_MILLI_VOLTS(reading_val);
	float reading_pressure = reading_volts * step_coeficient;
	float reading_temp = ADC_RESULT_IN_UNITS(reading_val);

	// sensor_value->val1 = adc_sample_buffer[0];
	sensor_value->val1 = (((reading_val - in_min) * ((out_max - out_min)) /
				      (in_max - in_min)) +
			      out_min);

	if (sensor_value->val1 <0 ){
		sensor_value->val1 = 0;
	}

	printf("Tcf %.3f\t", step_coeficient);
	// printf("mVolts %.3f\t", reading_volts);
	printf("mVolts %d\t", reading_volts);
	printf("Adjusted %.3f\t", reading_pressure);
	printf("Tempp (c) %.3f\t", reading_temp);	
	printk("Raw %d \t", reading_val);
	printk("Mapped %d \t", sensor_value->val1);

	printk("\n ");


	/**
 * strange mapping type function 
 * takes double (decimal) and recalibates to min and max range.
 * 
 * double map(double value, double in_min, double istop, double ostart, double ostop) 
 * 
 * 
 *  All values double (int32_t)
 * 
 * double value_map(x, in_min, in_max, out_min, out_max):
    return ((x-in_min) * (out_max-out_min) / (in_max-in_min) + out_min)

**/



/**
 * 
 * 
   Inputs ADC Value from Thermistor and outputs Temperature in Celsius
    requires: include <math.h>
   Utilizes the Steinhart-Hart Thermistor Equation:
      Temperature in Kelvin = 1 / {A + B[ln(R)] + C[ln(R)]3}
      where A = 0.001129148, B = 0.000234125 and C = 8.76741E-08

   These coefficients seem to work fairly universally, which is a bit of a
   surprise.

   Schematic:
     [Ground] -- [10k-pad-resistor] -- | -- [thermistor] --[Vcc (5 or 3.3v)]
                                                 |
                                            Analog Pin 0

   In case it isn't obvious (as it wasn't to me until I thought about it), the analog ports
   measure the voltage between 0v -> Vcc which for an Arduino is a nominal 5v, but for (say)
   a JeeNode, is a nominal 3.3v.

   The resistance calculation uses the ratio of the two resistors, so the voltage
   specified above is really only required for the debugging that is commented out below

   Resistance = PadResistor * (1024/ADC -1)

   I have used this successfully with some CH Pipe Sensors (http://www.atcsemitec.co.uk/pdfdocs/ch.pdf)
   which be obtained from http://www.rapidonline.co.uk.



#include <math.h>

#define ThermistorPIN A0                 // Analog Pin 0

float vcc = 4.91;                       // only used for display purposes, if used
// set to the measured Vcc.
float pad = 9850;                       // balance/pad resistor value, set this to
// the measured resistance of your pad resistor
float thermr = 10000;                   // thermistor nominal resistance

float Thermistor(int RawADC) {
  long Resistance;
  float Temp;  // Dual-Purpose variable to save space.

  Resistance = pad * ((1024.0 / RawADC) - 1);
  Temp = log(Resistance); // Saving the Log(resistance) so not to calculate  it 4 times later
  Temp = 1 / (0.001129148 + (0.000234125 * Temp) + (0.0000000876741 * Temp * Temp * Temp));
  Temp = Temp - 273.15;  // Convert Kelvin to Celsius

  // BEGIN- Remove these lines for the function not to display anything
  //Serial.print("ADC: ");
  //Serial.print(RawADC);
  //Serial.print("/1024");                           // Print out RAW ADC Number
  //Serial.print(", vcc: ");
  //Serial.print(vcc,2);
  //Serial.print(", pad: ");
  //Serial.print(pad/1000,3);
  //Serial.print(" Kohms, Volts: ");
  //Serial.print(((RawADC*vcc)/1024.0),3);
  //Serial.print(", Resistance: ");
  //Serial.print(Resistance);
  //Serial.print(" ohms, ");
  // END- Remove these lines for the function not to display anything

  // Uncomment this line for the function to return Fahrenheit instead.
  //temp = (Temp * 9.0)/ 5.0 + 32.0;                  // Convert to Fahrenheit
  return Temp;                                      // Return the Temperature
}

void setup() {
  pinMode(6, OUTPUT);
  digitalWrite(6, HIGH);
  pinMode(7, OUTPUT);
  digitalWrite(7, LOW);
  Serial.begin(9600);
}

void loop() {
  float temp;
  temp = Thermistor(1023 - analogRead(ThermistorPIN));     // read ADC and  convert it to Celsius
  Serial.print("Celsius: ");
  Serial.print(temp, 2);                            // display Celsius
  //temp = (temp * 9.0)/ 5.0 + 32.0;                  // converts to  Fahrenheit
  //Serial.print(", Fahrenheit: ");
  //Serial.print(temp,1);                             // display  Fahrenheit
  Serial.println("");
  delay(1000);                                      // Delay a bit...
}
 * 
 **/
	return;
}
```
